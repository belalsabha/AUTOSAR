[part 8 of 10: package /AUTOSAR/EcucDefs]
AUTOSAR XML (schema 00046)
package /AUTOSAR/EcucDefs  (continued)
  module definition LdCom [0..1]: post-build-variant-support=true, variants link-time/post-build/pre-compile  # Configuration of the AUTOSAR LdCom module.
    container LdComConfig  # This container contains the configuration parameters and sub containers of the AUTOSAR LdCom module.
      container LdComIPdu [0..*]: multiplicity set at link in variant link-time / post-build in variant post-build / pre-compile in variant pre-compile, post-build-variant-multiplicity=true  # Contains the configuration parameters of the IPdu inside LdCom.
        enumeration LdComApiType: {LDCOM_IF, LDCOM_TP}, scope=ECU, set at link in variant link-time+post-build / pre-compile in variant pre-compile  # Defines if this I-PDU is a normal I-PDU that shall be sent unfragmented or if this is a large I-PDU that shall be sent via the Transport Protocol of the underlying bus. | This setting is used by RTE to invoke the proper API.
        integer LdComHandleId: 0..65535, scope=ECU, set at pre-compile, symbolic-name-value=true  # This is the ID used by RTE to invoke LdCom. | A corresponding shortName is created, which is used for the invocations of the RTE. The same ID is used for invocations by PduR.
        enumeration LdComIPduDirection: {LDCOM_RECEIVE, LDCOM_SEND}, set at link in variant link-time+post-build / pre-compile in variant pre-compile  # The direction defines if this IPdu, and therefore the contributing signal, shall be sent or received.
        function name LdComRxCopyRxData [0..1]: scope=ECU, multiplicity set at link in variant link-time+post-build / pre-compile in variant pre-compile, set at link in variant link-time+post-build / pre-compile in variant pre-compile  # Only on receiver side: Name of Rte_LdComCbkCopyRxData callback function to be called.
        function name LdComRxIndication [0..1]: scope=ECU, multiplicity set at link in variant link-time+post-build / pre-compile in variant pre-compile, set at link in variant link-time+post-build / pre-compile in variant pre-compile  # Only on receiver side: Name of Rte_LdComCbkRxIndication callback function to be called.
        function name LdComRxStartOfReception [0..1]: scope=ECU, multiplicity set at link in variant link-time+post-build / pre-compile in variant pre-compile, set at link in variant link-time+post-build / pre-compile in variant pre-compile  # Only on receiver side: Name of Rte_LdComCbkStartOfReception callback function to be called.
        function name LdComTpRxIndication [0..1]: scope=ECU, multiplicity set at link in variant link-time+post-build / pre-compile in variant pre-compile, set at link in variant link-time+post-build / pre-compile in variant pre-compile  # Only on receiver side: Name of Rte_LdComCbkTpRxIndication callback function to be called.
        function name LdComTpTxConfirmation [0..1]: scope=ECU, multiplicity set at link in variant link-time+post-build / pre-compile in variant pre-compile, set at link in variant link-time+post-build / pre-compile in variant pre-compile  # Only on sender side: Name of Rte_LdComCbkTpTxConfirmation callback function to be called.
        function name LdComTxConfirmation [0..1]: scope=ECU, multiplicity set at link in variant link-time+post-build / pre-compile in variant pre-compile, set at link in variant link-time+post-build / pre-compile in variant pre-compile  # Only on sender side: Name of Rte_LdComCbkTxConfirmation callback function to be called.
        function name LdComTxCopyTxData [0..1]: scope=ECU, multiplicity set at link in variant link-time+post-build / pre-compile in variant pre-compile, set at link in variant link-time+post-build / pre-compile in variant pre-compile  # Only on sender side: Name of Rte_LdComCbkCopyTxData callback function to be called.
        function name LdComTxTriggerTransmit [0..1]: scope=ECU, multiplicity set at link in variant link-time+post-build / pre-compile in variant pre-compile, set at link in variant link-time+post-build / pre-compile in variant pre-compile  # Only on sender side: Name of Rte_LdComCbkTriggerTransmit callback function to be called. If defined TriggerTransmit has to be supported for this signal.
        reference LdComPduRef: scope=ECU, set at link in variant link-time+post-build / pre-compile in variant pre-compile, destination=Pdu  # Reference to the global Pdu.
        foreign reference LdComSystemTemplateSignalRef [0..1]: scope=ECU, multiplicity set at link in variant link-time / post-build in variant post-build / pre-compile in variant pre-compile, post-build-variant-multiplicity=true, post-build-variant-value=true, set at link in variant link-time / post-build in variant post-build / pre-compile in variant pre-compile, destination-type=I-SIGNAL-TO-I-PDU-MAPPING  # Reference to the ISignalToIPduMapping that contains a reference to the ISignal (System Template).
    container LdComGeneral  # Contains the general configuration parameters of the LdCom module.
      boolean LdComDevErrorDetect: set at pre-compile, default-value=false  # Switches the development error detection and notification on or off. | * true: detection and notification is enabled. * false: detection and notification is disabled.
      boolean LdComVersionInfoApi: set at pre-compile, default-value=false  # Activate/Deactivate the version information API (LdCom_GetVersionInfo). | * True: version information API activated * False: version information API deactivated
  module definition Lin [0..*]: post-build-variant-support=true, variants post-build/pre-compile  # Configuration of the Lin (LIN driver) module.
    container LinDemEventParameterRefs [0..1]  # Container for the references to DemEventParameter elements which shall be invoked using the API Dem_SetEventStatus in case the corresponding error occurs. The EventId is taken from the referenced DemEventParameter's DemEventId symbolic value. The standardized errors are provided in this container and can be extended by vendor-specific error references.
      reference LIN_E_TIMEOUT [0..1]: multiplicity set at pre-compile, set at pre-compile, requires-symbolic-name-value=true, destination=DemEventParameter  # Reference to the DemEventParameter which shall be issued when the error "Timeout caused by hardware error" has occurred. If the reference is not configured the error shall be reported as DET error.
    container LinGeneral  # This container contains the parameters related to each LIN Driver Unit.
      boolean LinDevErrorDetect: set at pre-compile, default-value=false  # Switches the development error detection and notification on or off. | * true: detection and notification is enabled. * false: detection and notification is disabled.
      integer LinIndex: 0..255, set at pre-compile  # Specifies the InstanceId of this module instance. If only one instance is present it shall have the Id 0.
      integer LinTimeoutDuration: 0..65535, set at pre-compile  # Specifies the maximum number of loops for blocking function until a timeout is raised in short term wait loops
      boolean LinVersionInfoApi: set at pre-compile, default-value=false  # Switches the Lin_GetVersionInfo function ON or OFF.
      reference LinEcucPartitionRef [0..*]: scope=ECU, multiplicity set at pre-compile, post-build-variant-multiplicity=true, post-build-variant-value=true, set at pre-compile, destination=EcucPartition  # Maps the Lin driver to zero or multiple ECUC partitions to make the modules API available in this partition. The Lin driver will operate as an independent instance in each of the partitions. Tags: atp.Status=draft
    container LinGlobalConfig  # This container contains the global configuration parameter of the Lin driver.
      container LinChannel [1..*]  # This container contains the configuration (parameters) of the LIN Controller(s).
        integer LinChannelBaudRate: 1000..20000, post-build-variant-value=true, set at post-build in variant post-build / pre-compile in variant pre-compile  # Specifies the baud rate of the LIN channel
        integer LinChannelId: 0..65535, set at pre-compile, symbolic-name-value=true  # Identifies the LIN channel. Replaces LIN_CHANNEL_INDEX_NAME from the LIN SWS.
        boolean LinChannelWakeupSupport: set at pre-compile  # Specifies if the LIN hardware channel supports wake up functionality
        enumeration LinNodeType: {MASTER, SLAVE}, set at pre-compile  # Specifies the LIN node type of this channel.
        reference LinChannelEcucPartitionRef [0..1]: scope=ECU, multiplicity set at pre-compile, post-build-variant-multiplicity=true, post-build-variant-value=true, set at pre-compile, destination=EcucPartition  # Maps one single Lin channel to zero or one ECUC partitions. The ECUC partition referenced is a subset of the ECUC partitions where the Lin driver is mapped to. Tags: atp.Status=draft
        reference LinChannelEcuMWakeupSource [0..1]: multiplicity set at pre-compile, set at pre-compile, requires-symbolic-name-value=true, destination=EcuMWakeupSource  # This parameter contains a reference to the Wakeup Source for this controller as defined in the ECU State Manager.
        reference LinClockRef: post-build-variant-value=true, set at post-build in variant post-build / pre-compile in variant pre-compile, destination=McuClockReferencePoint  # Reference to the LIN clock source configuration, which is set in the MCU driver configuration.
  module definition LinIf [0..1]: post-build-variant-support=true, variants link-time/post-build/pre-compile  # Configuration of the LinIf (LIN Interface) module.
    container LinIfGeneral  # This container contains the general parameters of LIN Interface module.
      boolean LinIfBusMirroringSupported: set at pre-compile, default-value=false  # States if Bus Mirroring is enabled in the LIN Interface or not. The reason for this parameter is to reduce the size of LIN Interface if the Bus Mirroring is not used.
      boolean LinIfDevErrorDetect: set at pre-compile, default-value=false  # Switches the development error detection and notification on or off. | * true: detection and notification is enabled. * false: detection and notification is disabled.
      boolean LinIfMultipleDriversSupported: set at pre-compile  # States if multiple drivers are supported by the LIN Interface or not. The reason for this parameter is to reduce the size of LIN Interface if multiple drivers are not used.
      boolean LinIfMultipleTrcvDriverSupported: set at pre-compile  # States if multiple transceiver drivers are supported by the LIN Interface or not. The reason for this parameter is to reduce the size of LIN Interface if multiple transceiver drivers are not used.
      boolean LinIfNcOptionalRequestSupported: set at pre-compile  # States if the node configuration commands Assign NAD and Conditional Change NAD are supported.
      string LinIfPublicCddHeaderFile [0..*]: scope=ECU, multiplicity set at pre-compile, set at pre-compile, max-length=32, min-length=1  # Defines header files for callback functions which shall be included in case of CDDs. Range of characters is 1.. 32.
      function name LinIfResponseErrorSignalChangedCallout [0..1]: set at pre-compile  # This parameter contains the name of the callout function that is called after a response error signal change. | Only applicable for LIN slave nodes.
      function name LinIfSaveConfigurationCallout [0..1]: set at pre-compile  # This parameter contains the name of the callout function that is called when a save configuration node configuration command is processed by this slave node. The service is only supported when this parameter is configured. | Only applicable for LIN slave nodes.
      boolean LinIfTpSupported: set at pre-compile  # States if the TP is included in the LIN Interface or not. The reason for this parameter is to reduce the size of LIN Interface if the TP is not used.
      boolean LinIfTrcvDriverSupported: set at pre-compile  # States if transceiver driver support is included in the LIN Interface or not. The reason for this parameter is to reduce the size of LIN Interface if transceiver drivers are not used.
      boolean LinIfVersionInfoApi: set at pre-compile, default-value=false  # Switches the LinIf_GetVersionInfo function ON or OFF.
    container LinIfGlobalConfig  # This container contains the global configuration parameters of the LinIf.
      container LinIfChannel [1..*]: multiplicity set at pre-compile  # Describes each LIN channel the LinIf is connected to.
        float LinIfBusIdleTimeoutPeriod: 0.1..Inf, post-build-variant-value=true, set at link in variant link-time / post-build in variant post-build / pre-compile in variant pre-compile, default-value=4  # Bus idle timeout in seconds. | According to the LIN protocol specification, the bus idle timeout period shall be in range [4, 10] seconds.
        enumeration LinIfGotoSleepConfirmationUL: {CDD, LIN_SM}, scope=ECU, post-build-variant-value=true, set at link in variant link-time+post-build / pre-compile in variant pre-compile  # This parameter defines the upper layer (UL) module to which the confirmation of the goto-sleep command shall be sent.
        enumeration LinIfGotoSleepIndicationUL [0..1]: {CDD, LIN_SM}, scope=ECU, post-build-variant-value=true, set at link in variant link-time+post-build / pre-compile in variant pre-compile  # This parameter defines the upper layer (UL) module to which the indication of the goto-sleep command shall be sent. | Only used for LIN Slave nodes, ignored for master nodes.
        float LinIfMainFunctionPeriod: 0..Inf, set at link in variant link-time+post-build / pre-compile in variant pre-compile  # Defines the interval of calls to main functions per channel in seconds.
        integer LinIfMaxFrameCnt [0..1]: 0..65535, multiplicity set at link in variant link-time+post-build / pre-compile in variant pre-compile, set at link in variant link-time+post-build / pre-compile in variant pre-compile  # Maximum number of Frames. This parameter is needed only in case of post-build loadable implementation using static memory allocation.
        boolean LinIfScheduleChangeNextTimeBase [0..1]: post-build-variant-value=true, set at link in variant link-time / post-build in variant post-build / pre-compile in variant pre-compile  # Enables/disables the switch to a new schedule table at the start of the next time base after status check. | True: LinIf selects a new schedule table in next main function. Only applicable for LIN Master nodes.
        enumeration LinIfScheduleRequestConfirmationUL [0..1]: {CDD, LIN_SM}, scope=ECU, post-build-variant-value=true, set at link in variant link-time+post-build / pre-compile in variant pre-compile  # This parameter defines the upper layer (UL) module to which the confirmation of the successfully performed schedule table change shall be sent. | Only applicable to LIN master nodes.
        enumeration LinIfWakeupConfirmationUL: {CDD, LIN_SM}, scope=ECU, post-build-variant-value=true, set at link in variant link-time+post-build / pre-compile in variant pre-compile  # This parameter defines the upper layer (UL) module to which the confirmation of the wake-up shall be sent.
        foreign reference LinIfCddRef [0..1]: multiplicity set at pre-compile, set at pre-compile, destination-type=ECUC-MODULE-CONFIGURATION-VALUES  # Reference to the CDD module description. This parameter is only required when LinIfWakeupConfirmationUL, LinIfScheduleRequestConfirmationUL, LinIfGotoSleepConfirmationUL and/or LinIfGotoSleepIndicationUL is set to CDD.
        reference LinIfChannelRef: scope=ECU, set at link in variant link-time+post-build / pre-compile in variant pre-compile, requires-symbolic-name-value=true, destination=LinChannel  # Reference to the channel definition in the LIN driver.
        reference LinIfComMNetworkHandleRef: set at link in variant link-time+post-build / pre-compile in variant pre-compile, requires-symbolic-name-value=true, destination=ComMChannel  # Unique handle to identify one LIN network. Reference to one of the network handles configured for the ComM.
        container LinIfFrame [0..*]: multiplicity set at link in variant link-time / post-build in variant post-build / pre-compile in variant pre-compile, post-build-variant-multiplicity=true  # Generic container for all types of LIN frames.
          enumeration LinIfChecksumType [0..1]: {CLASSIC, ENHANCED}, post-build-variant-value=true, set at link in variant link-time / post-build in variant post-build / pre-compile in variant pre-compile  # Type of checksum that the frame is using. | This parameter is optional because in case of sporadic frames it should not be set.
          integer LinIfFrameId [0..1]: 0..63, multiplicity set at link in variant link-time / post-build in variant post-build / pre-compile in variant pre-compile, post-build-variant-multiplicity=true, post-build-variant-value=true, set at link in variant link-time / post-build in variant post-build / pre-compile in variant pre-compile  # ID of the LIN frame. The Protected ID including parity is calculated by the generation tool.
          integer LinIfFrameIndex [0..1]: 0..63, multiplicity set at link in variant link-time / post-build in variant post-build / pre-compile in variant pre-compile, post-build-variant-multiplicity=true, post-build-variant-value=true, set at link in variant link-time / post-build in variant post-build / pre-compile in variant pre-compile  # PID index of the frame. This index is used in the AssignFrameIdentifierRange node configuration service to identify the frame(s) to which a new PID shall be assigned. | It corresponds to the order of the frames in the configurable frames list in the node attributes section of the LDF / NCF of the slave node. Only relevant for LIN slave nodes.
          enumeration LinIfFrameType: {ASSIGN, ASSIGN_FRAME_ID_RANGE, ASSIGN_NAD, CONDITIONAL, EVENT_TRIGGERED, FREE, MRF, SAVE_CONFIGURATION, SPORADIC, SRF, UNASSIGN, UNCONDITIONAL}, post-build-variant-value=true, set at link in variant link-time / post-build in variant post-build / pre-compile in variant pre-compile  # This parameter defines the type of frame (e.g. sporadic frame). | For master nodes, all frame types are permitted. A sporadic slot may be used by a set of unconditional frames in the role of substitution frames. For slave nodes, only following types are permitted: Uncondtional, MRF, SRF, Event-triggered. An event-triggered slot may be used by a set of unconditional frames in the role of substitution frames.
          container LinIfFixedFrameSdu [0..1]  # In case this is a fixed frame this is the SDU (response). | This container represents an eight byte array. The Byte order shall be MSB first. Only applicable to LIN master nodes.
            container LinIfFixedFrameSduByte [8..8]  # This container represents a byte within the 8 byte array.
              integer LinIfFixedFrameSduBytePos: 0..7, post-build-variant-value=true, set at link in variant link-time / post-build in variant post-build / pre-compile in variant pre-compile  # Index of the Byte in the SDU (response) 8 byte array.
              integer LinIfFixedFrameSduByteVal: 0..255, post-build-variant-value=true, set at link in variant link-time / post-build in variant post-build / pre-compile in variant pre-compile  # Byte value in the SDU (response) 8-byte array.
          choice container LinIfPduDirection [0..1]  # Direction of the frame
            container LinIfInternalPdu [0..1]  # Represents a Diagnostic or Configuration frame : no Message ID (no PduId). | Only applicable to LIN master nodes.
            container LinIfRxPdu [0..1]  # represents a received PDU/frame
              function name LinIfRxIndicationUL [0..1]: scope=ECU, multiplicity set at link in variant link-time+post-build / pre-compile in variant pre-compile, post-build-variant-multiplicity=true, post-build-variant-value=true, set at link in variant link-time+post-build / pre-compile in variant pre-compile  # This parameter defines the name of the <User_RxIndication>. This parameter depends on the parameter LinIfUserRxIndicationUL. | If LinIfUserRxIndicationUL equals PDUR, the name of the <User_RxIndication> is fixed. If LinIfUserRxIndicationUL equals CDD, the name of the <User_RxIndication> is selectable.
              enumeration LinIfUserRxIndicationUL: {CDD, PDUR}, scope=ECU, post-build-variant-value=true, set at link in variant link-time+post-build / pre-compile in variant pre-compile  # This parameter defines the upper layer (UL) module to which the indication of the successfully received LinIfRxPdu has to be routed via <User_RxIndication>.
              reference LinIfRxPduRef: scope=ECU, post-build-variant-value=true, set at link in variant link-time / post-build in variant post-build / pre-compile in variant pre-compile, destination=Pdu  # Reference to the PDU that is received in this frame.
            container LinIfSlaveToSlavePdu [0..1]  # Represents a slave-to-slave PDU/frame. Master does only send the header but doesn't receive the response. | Only relevant for master nodes.
            container LinIfTxPdu [0..1]  # represents a transmitted PDU/frame
              function name LinIfTxConfirmationUL [0..1]: scope=ECU, multiplicity set at link in variant link-time+post-build / pre-compile in variant pre-compile, post-build-variant-multiplicity=true, post-build-variant-value=true, set at link in variant link-time+post-build / pre-compile in variant pre-compile  # This parameter defines the name of the <User_TxConfirmation>. This parameter depends on the parameter LinIfUserTxUL. | If LinIfUserTxUL equals PDUR, the name of the <User_TxConfirmation> is fixed. If LinIfUserTxUL equals CDD, the name of the <User_TxConfirmation> is selectable.
              integer LinIfTxPduId: 0..65535, set at pre-compile, symbolic-name-value=true  # Identifier of the Pdu for the upper layer.
              function name LinIfTxTriggerTransmitUL [0..1]: scope=ECU, multiplicity set at link in variant link-time+post-build / pre-compile in variant pre-compile, post-build-variant-multiplicity=true, post-build-variant-value=true, set at link in variant link-time+post-build / pre-compile in variant pre-compile  # This parameter defines the name of the <User_TriggerTransmit>. This parameter depends on the parameter LinIfUserTxUL. If LinIfUserTxUL equals PDUR, the name of the <User_TriggerTransmit> is fixed. | If LinIfUserTxUL equals CDD, the name of the <User_TriggerTransmit> is selectable.
              enumeration LinIfUserTxUL: {CDD, PDUR}, scope=ECU, post-build-variant-value=true, set at link in variant link-time+post-build / pre-compile in variant pre-compile  # This parameter defines the upper layer (UL) module to which the trigger of the transmitted LinTxPdu (via the <User_TriggerTransmit>) or the confirmation of the successfully transmitted LinTxPdu has to be routed (via the <User_TxConfirmation>).
              reference LinIfTxPduRef: scope=ECU, post-build-variant-value=true, set at link in variant link-time / post-build in variant post-build / pre-compile in variant pre-compile, destination=Pdu  # Reference to the PDU that is transmitted in this frame.
          container LinIfSubstitutionFrames [0..*]  # List of sporadic frames that can be sent in a sporadic frame slot (master node) or list of unconditional frames that can be sent in an event-triggered frame slot (slave node).
            integer LinIfFramePriority: 0..255, post-build-variant-value=true, set at link in variant link-time / post-build in variant post-build / pre-compile in variant pre-compile  # Priority of sporadic frame in a master node or of event-triggered frame in slave node.
            reference LinIfSubstitutionFrameRef: post-build-variant-value=true, set at link in variant link-time / post-build in variant post-build / pre-compile in variant pre-compile, destination=LinIfFrame  # Reference to an unconditional Frame that is used as sporadic frame in a master node or event-triggered frame in a slave node.
        choice container LinIfNodeType  # This container defines the LIN node type of this channel.
          container LinIfMaster [0..1]  # Each Master can only be connected to one physical channel. This could be compared to the Node parameter in a LDF file.
            float LinIfJitter: 0..0.255, set at pre-compile  # The jitter specifies the differences between the maximum and minimum delay from time base tick to the header sending start point in seconds.
          container LinIfSlave [0..1]  # Describes all parameters which are only relevant for a LIN Slave node.
            enumeration LinIfLinProtocolVersion: {ISO17987, LIN13, LIN20, LIN21, LIN22}, set at pre-compile  # Defines the LIN protocol version of the slave node. | This information is relevant for the LIN conformance test execution.
            reference LinIfResponseErrorSignal [0..1]: scope=ECU, set at link in variant link-time+post-build / pre-compile in variant pre-compile, requires-symbolic-name-value=true, destination=ComSignal  # Reference to the response_error signal. | Mandatory for all LIN 2.x and ISO LIN slave nodes, not relevant for LIN 1.3 slave nodes.
            container LinIfNodeConfigurationIdentification [0..1]  # This container is mandatory for all LIN 2.x and ISO17987 LIN slave nodes, and ignored for LIN 1.3 slave nodes and all master nodes,
              integer LinIfConfiguredNAD: 1..125, post-build-variant-value=true, set at link in variant link-time / post-build in variant post-build / pre-compile in variant pre-compile  # Slave node configured NAD.
              integer LinIfFunctionId: 0..65535, post-build-variant-value=true, set at link in variant link-time / post-build in variant post-build / pre-compile in variant pre-compile  # LIN function Id.
              integer LinIfInitialNAD: 1..125, post-build-variant-value=true, set at link in variant link-time / post-build in variant post-build / pre-compile in variant pre-compile  # Slave node initial NAD.
              float LinIfNasTimeout: 0..1, post-build-variant-value=true, set at link in variant link-time / post-build in variant post-build / pre-compile in variant pre-compile  # N_As timeout in seconds.
              integer LinIfSupplierId: 0..32767, post-build-variant-value=true, set at link in variant link-time / post-build in variant post-build / pre-compile in variant pre-compile  # LIN consortium or ISO LIN supplier Id.
              integer LinIfVariantId: 0..255, post-build-variant-value=true, set at link in variant link-time / post-build in variant post-build / pre-compile in variant pre-compile  # LIN variant Id.
        container LinIfScheduleTable [0..*]: multiplicity set at link in variant link-time / post-build in variant post-build / pre-compile in variant pre-compile, post-build-variant-multiplicity=true  # Describes a schedule table. Each LinIfChannel may have several schedule tables. Each schedule table can only be connected to one channel. | Mandatory for LIN Master nodes. The SHORT-NAME of the LinIfScheduleTable container represents the symbolic name of the schedule table.
          enumeration LinIfResumePosition: {CONTINUE_AT_IT_POINT, START_FROM_BEGINNING}, post-build-variant-value=true, set at link in variant link-time / post-build in variant post-build / pre-compile in variant pre-compile  # Defines where a RUN_CONTINUOUS schedule table shall proceed in case it has been interrupted by a RUN_ONCE table.
          enumeration LinIfRunMode: {RUN_CONTINUOUS, RUN_ONCE}, post-build-variant-value=true, set at link in variant link-time / post-build in variant post-build / pre-compile in variant pre-compile  # The schedule table can be executed in two different modes.
          integer LinIfScheduleTableIndex: 0..255, set at pre-compile, symbolic-name-value=true  # This is the unique index used by upper layers to identify a schedule. Note that the NULL_SCHEDULE for each channel must have index 0.
          container LinIfEntry [0..*]: multiplicity set at link in variant link-time / post-build in variant post-build / pre-compile in variant pre-compile, post-build-variant-multiplicity=true  # Describes an entry in the schedule table (also known as Frame Slot).
            float LinIfDelay: 0..0.255, post-build-variant-value=true, set at link in variant link-time / post-build in variant post-build / pre-compile in variant pre-compile  # Delay to next entry in schedule table in seconds.
            integer LinIfEntryIndex: 0..255, post-build-variant-value=true, set at link in variant link-time / post-build in variant post-build / pre-compile in variant pre-compile  # Position of the Frame Entry in the Schedule Table. The first entry index in the schedule table is 0.
            reference LinIfCollisionResolvingRef [0..1]: post-build-variant-value=true, set at link in variant link-time / post-build in variant post-build / pre-compile in variant pre-compile, destination=LinIfScheduleTable  # Reference to the schedule table, which resolves the collision. This parameter is only used if the referenced frames are event triggered frames.
            reference LinIfFrameRef: post-build-variant-value=true, set at link in variant link-time / post-build in variant post-build / pre-compile in variant pre-compile, destination=LinIfFrame  # Reference to the frames that belong to this schedule table entry.
        container LinIfTransceiverDrvConfig [0..1]  # This container contains the configuration parameters of each underlying LIN Transceiver Driver.
          reference LinIfTrcvIdRef: scope=ECU, set at link in variant link-time+post-build / pre-compile in variant pre-compile, requires-symbolic-name-value=true, destination=LinTrcvChannel  # Logical handle of the underlying LIN transceiver to be served by the LIN Interface.
  module definition LinNm [0..1]: variants link-time/pre-compile  # Configuration Parameters for the Lin Nm module.
    container LinNmGlobalConfig  # This container contains the global configuration parameter of the LinNm.
      boolean LinNmBusSynchronizationEnabled: set at pre-compile  # Pre-processor switch for enabling bus synchronization support of the LinNm. This feature is required for NM Coordinator nodes only.
      boolean LinNmComControlEnabled: set at pre-compile  # Pre-processor switch for enabling the Communication Control support.
      boolean LinNmCoordinatorSyncSupport: set at pre-compile  # Enables/disables the coordinator synchronization support.
      boolean LinNmDevErrorDetect: set at pre-compile, default-value=false  # Switches the development error detection and notification on or off. | * true: detection and notification is enabled. * false: detection and notification is disabled.
      float LinNmMainFunctionPeriod: 0..Inf, set at link in variant link-time / pre-compile in variant pre-compile  # Call cycle in seconds of LinNm_MainFunction.
      boolean LinNmPassiveModeEnabled: set at pre-compile  # Pre-processor switch for enabling support of the Passive Mode of the LinNm.
      boolean LinNmRemoteSleepIndicationEnabled: set at pre-compile  # Pre-processor switch for enabling Remote Sleep Indication support. This feature is required for NM Coordinator nodes only.
      boolean LinNmStateChangeIndEnabled: set at pre-compile  # Pre-processor switch for enabling the Network Management state change notification.
      boolean LinNmSynchronizationPointEnabled: set at pre-compile, default-value=false  # Pre-processor switch for enabling the Synchronize NM feature.
      boolean LinNmUserDataEnabled: set at pre-compile  # Pre-processor switch for enabling User Data support.
      boolean LinNmVersionInfoApi: set at pre-compile, default-value=false  # Pre-processor switch for enabling version info API support.
      container LinNmChannelConfig [1..*]  # This container contains the channel specific configuration parameter of the LinNm.
        boolean LinNmNodeDetectionEnabled [0..1]: set at pre-compile  # Pre-processor switch for enabling the Node Detection feature.
        boolean LinNmNodeIdEnabled [0..1]: set at pre-compile  # Pre-processor switch for enabling transmission of the source node identifier in NM messages.
        float LinNmTimeoutTime: 0..65.535, scope=ECU, set at link in variant link-time / pre-compile in variant pre-compile  # Network Timeout after passive start-up. It denotes the time in seconds how long the NM shall stay in Network Mode in case of passive start-up before transition into Bus-Sleep Mode is initiated.
        reference LinNmComMNetworkHandleRef: scope=ECU, set at link in variant link-time / pre-compile in variant pre-compile, requires-symbolic-name-value=true, destination=ComMChannel  # This reference points to the unique channel defined by the ComMChannel and provides access to the unique channel index value in ComMChannelId.
  module definition LinSM [0..1]: post-build-variant-support=true, variants link-time/post-build/pre-compile  # Configuration of the Lin State Manager module.
    container LinSMConfigSet  # This container contains the configuration parameters and sub containers of the AUTOSAR LinSm module.
      integer LinSMModeRequestRepetitionMax: 0..255, post-build-variant-value=true, set at link in variant link-time / post-build in variant post-build / pre-compile in variant pre-compile  # Specifies the maximal amount of mode request repetitions without a respective mode indication from the LinIf module until the LinSM module reports a Development Error to the Det and tries to go back to no communication.
      container LinSMChannel [1..*]  # Describes each LIN channel the LinSM is connected to.
        float LinSMConfirmationTimeout: 0..Inf, set at link in variant link-time+post-build / pre-compile in variant pre-compile  # Timeout in seconds for the goto sleep, wakeup and schedule request calls to LinIf. The timeout must be longer than a goto-sleep command on the bus (i.e. it is bit rate dependent).
        enumeration LinSMNodeType: {MASTER, SLAVE}, set at pre-compile  # Specifies the LIN node type of this channel.
        float LinSMSilenceAfterWakeupTimeout [0..1]: 0..Inf, set at link in variant link-time+post-build / pre-compile in variant pre-compile  # Timeout in seconds after a failed wakeup sequence until a new wakeup process is started.
        boolean LinSMTransceiverPassiveMode [0..1]: multiplicity set at link in variant link-time+post-build / pre-compile in variant pre-compile, set at link in variant link-time+post-build / pre-compile in variant pre-compile  # Selects STANDBY (true) or SLEEP (false) transceiver mode when entering LINSM_NO_COM.
        reference LinSMComMNetworkHandleRef: set at link in variant link-time+post-build / pre-compile in variant pre-compile, requires-symbolic-name-value=true, destination=ComMChannel  # Unique handle to identify one certain LIN network. Reference to one of the network handles configured in the ComM.
        container LinSMSchedule [0..*]  # The schedule references to a schedule that is located in the LinIf configuration. Moreover, the PDU groups are located in the COM configuration. Note that there are two references to PDU groups. The simple reason is that a PDU group is only allowed to contain one direction (TX or RX). | Only applicable to LIN master nodes.
          integer LinSMScheduleIndex: 0..255, set at pre-compile, symbolic-name-value=true  # This index parameter can be used by the BswM as a SymbolicNameReference target. The LinSM just forwards the request from the BswM to LinIf. Note that the value of the LinSMScheduleIndex shall be the same as the value from the LinIf.
          reference LinSMScheduleIndexRef: post-build-variant-value=true, set at link in variant link-time / post-build in variant post-build / pre-compile in variant pre-compile, requires-symbolic-name-value=true, destination=LinIfScheduleTable  # Reference to a schedule table in the LinIf configuration
    container LinSMGeneral  # This container contains general parameters of LIN State Manager module.
      boolean LinSMDevErrorDetect: set at pre-compile, default-value=false  # Switches the development error detection and notification on or off. | * true: detection and notification is enabled. * false: detection and notification is disabled.
      float LinSMMainProcessingPeriod: 0..Inf, set at pre-compile  # Fixed period that the MainFunction shall be called.
      boolean LinSMVersionInfoApi: set at pre-compile, default-value=false  # Switches the LinSM_GetVersionInfo function ON or OFF.
  module definition LinTp [0..1]: post-build-variant-support=true, variants link-time/post-build/pre-compile  # Configuration of the LIN Transport Protocol.
    container LinTpGeneral  # Container that holds all LIN transport protocol general parameters.
      boolean LinTpChangeParameterApi: set at pre-compile  # This parameter, if set to true, enables the LinTp_ChangeParameter Api for this Module.
      boolean LinTpVersionInfoApi: set at pre-compile, default-value=false  # Switches the LinTp_GetVersionInfo function ON or OFF.
    container LinTpGlobalConfig  # This container contains the global configuration parameters of the LinTp.
      integer LinTpMaxRxNSduCnt [0..1]: 0..65535, set at link in variant link-time+post-build / pre-compile in variant pre-compile  # Maximum number of NSdus. This parameter is needed only in case of post-build loadable implementation using static memory allocation.
      integer LinTpMaxTxNSduCnt [0..1]: 0..65535, set at link in variant link-time+post-build / pre-compile in variant pre-compile  # Maximum number of NSdus. This parameter is needed only in case of post-build loadable implementation using static memory allocation.
      container LinTpChannelConfig [0..*]: multiplicity set at link in variant link-time / post-build in variant post-build / pre-compile in variant pre-compile, post-build-variant-multiplicity=true  # This container contains the channel specific configuration parameters of LinTp.
        boolean LinTpDropNotRequestedNad: post-build-variant-value=true, set at link in variant link-time / post-build in variant post-build / pre-compile in variant pre-compile, default-value=true  # Configures if TP Frames of not requested LIN-Slaves are dropped or not. | TRUE: Drop TP Frames of not requested LIN-Slaves FALSE: Keep TP Frames of not requested LIN-Slaves Only used for LIN Master nodes, ignored for slave nodes.
        integer LinTpMaxNumberOfRespPendingFrames: 0..65535, post-build-variant-value=true, set at link in variant link-time / post-build in variant post-build / pre-compile in variant pre-compile  # Configures the maximum number of allowed response pending frames. | Only used for LIN Master nodes, ignored for slave nodes.
        float LinTpP2Max: 0.05..2, post-build-variant-value=true, set at link in variant link-time / post-build in variant post-build / pre-compile in variant pre-compile  # P2*max timeout when a response pending frame is expected in seconds. | Note that the minimum value of LinTpP2Max shall be more than or equal to the value of LinTpP2Timing. Only used for LIN Master nodes, ignored for slave nodes.
        float LinTpP2Timing: 0.05..0.5, post-build-variant-value=true, set at link in variant link-time / post-build in variant post-build / pre-compile in variant pre-compile  # Definition of the P2max timeout observation parameter in seconds. | Only used for LIN Master nodes, ignored for slave nodes.
        boolean LinTpScheduleChangeDiag: post-build-variant-value=true, set at link in variant link-time / post-build in variant post-build / pre-compile in variant pre-compile, default-value=false  # Enables or disables the call of BswM_LinTp_RequestMode() to diagnostic request/response schedule. | false: BswM is not called true: BswM is called Only used for LIN Master nodes, ignored for slave nodes.
        reference LinTpChannelRef: post-build-variant-value=true, set at link in variant link-time / post-build in variant post-build / pre-compile in variant pre-compile, requires-symbolic-name-value=true, destination=ComMChannel  # Index of the channel this LinTp channel belongs to.
      container LinTpRxNSdu [0..*]: multiplicity set at link in variant link-time / post-build in variant post-build / pre-compile in variant pre-compile, post-build-variant-multiplicity=true  # This container exists once for each received N-SDU on any channel the node is connected to. This N-SDU produces meta data items of type LIN_NAD_8.
        float LinTpNcr [0..1]: 0..1, multiplicity set at link in variant link-time / post-build in variant post-build / pre-compile in variant pre-compile, post-build-variant-multiplicity=true, post-build-variant-value=true, set at link in variant link-time / post-build in variant post-build / pre-compile in variant pre-compile  # Value in seconds of the N_Cr timeout. N_Cr is the time until reception of the next Consecutive Frame N_PDU.
        integer LinTpRxNSduId: 0..65535, set at pre-compile, symbolic-name-value=true  # The identifier of the Transport Protocol message. This ID will be used by upper layers to call LinTp_ChangeParameter.
        integer LinTpRxNSduNad: 0..255, post-build-variant-value=true, set at link in variant link-time / post-build in variant post-build / pre-compile in variant pre-compile  # A N-SDU transported on LIN is identified using the NAD for the specific slave.
        reference LinTpRxNSduChannelRef: set at link in variant link-time+post-build / pre-compile in variant pre-compile, requires-symbolic-name-value=true, destination=ComMChannel  # Index of the channel this N-SDU belongs to.
        reference LinTpRxNSduPduRef: scope=ECU, post-build-variant-value=true, set at link in variant link-time / post-build in variant post-build / pre-compile in variant pre-compile, destination=Pdu  # Reference to the global PDU
      container LinTpTxNSdu [0..*]: multiplicity set at link in variant link-time / post-build in variant post-build / pre-compile in variant pre-compile, post-build-variant-multiplicity=true  # This container exists once for each transmitted N-SDU on any channel the node is connected to. This N-SDU consumes meta data items of type LIN_NAD_8.
        integer LinTpMaxBufReq: 0..255, post-build-variant-value=true, set at link in variant link-time / post-build in variant post-build / pre-compile in variant pre-compile  # This parameter defines the maximum number of times the LinTp should request upper layer for the Tx Buffer. It is also used to limit the number of retries for PduR_LinTpCopyTxData when no timer is active.
        float LinTpNas: 0..1, post-build-variant-value=true, set at link in variant link-time / post-build in variant post-build / pre-compile in variant pre-compile  # Value in seconds of the N_As timeout. N_As is the time for transmission of a LIN frame (any N_PDU) on the part of the sender.
        float LinTpNcs [0..1]: 0..Inf, multiplicity set at link in variant link-time / post-build in variant post-build / pre-compile in variant pre-compile, post-build-variant-multiplicity=true, post-build-variant-value=true, set at link in variant link-time / post-build in variant post-build / pre-compile in variant pre-compile  # Value in seconds of the performance requirement of N_Cs. N_Cs is the time which elapses between the transmit request of a CF N-PDU until the transmit request of the next CF N-PDU.
        integer LinTpTxNSduId: 0..65535, set at pre-compile, symbolic-name-value=true  # The identifier of the Transport Protocol message. This ID will be the one that is communicated with upper layers.
        integer LinTpTxNSduNad: 0..255, post-build-variant-value=true, set at link in variant link-time / post-build in variant post-build / pre-compile in variant pre-compile  # A N-SDU transported on LIN is identified using the NAD for the specific slave.
        reference LinTpTxNSduChannelRef: set at link in variant link-time+post-build / pre-compile in variant pre-compile, requires-symbolic-name-value=true, destination=ComMChannel  # Index of the channel this N-SDU belongs to.
        reference LinTpTxNSduPduRef: scope=ECU, post-build-variant-value=true, set at link in variant link-time / post-build in variant post-build / pre-compile in variant pre-compile, destination=Pdu  # Reference to the global PDU
  module definition LinTrcv [0..*]: variants pre-compile  # Configuration of LIN Transceiver Driver module
    container LinTrcvChannel [1..*]  # Container gives LIN transceiver driver information about a single LIN transceiver channel. Any LIN transceiver driver has such LIN transceiver channels.
      integer LinTrcvChannelId: 0..255, set at pre-compile, symbolic-name-value=true  # Unique identifier of the LIN Transceiver Channel.
      boolean LinTrcvChannelUsed: set at pre-compile, default-value=true  # Shall the related LIN transceiver channel be used? | True: Is used False Is not used
      boolean LinTrcvWakeupByBusUsed: set at pre-compile, default-value=false  # Is wake up by bus supported? If LIN transceiver hardware does not support wake up by bus value is always FALSE. If LIN transceiver hardware supports wake up by bus value is TRUE or FALSE depending whether it is used or not. | TRUE = Is used. FALSE = Is not used.
      reference LinTrcvChannelEcucPartitionRef [0..1]: scope=ECU, multiplicity set at pre-compile, post-build-variant-multiplicity=true, post-build-variant-value=true, set at pre-compile, destination=EcucPartition  # Maps one single Lin transceiver channel to zero or one ECUC partitions. The ECUC partition referenced is a subset of the ECUC partitions where the Lin transceiver driver is mapped to. Tags: atp.Status=draft
      reference LinTrcvIcuChannelRef [0..1]: scope=ECU, multiplicity set at pre-compile, set at pre-compile, requires-symbolic-name-value=true, destination=IcuChannel  # Reference to the IcuChannel to enable/disable the interrupts for wakeups.
      reference LinTrcvWakeupSourceRef [0..1]: scope=ECU, multiplicity set at pre-compile, set at pre-compile, requires-symbolic-name-value=true, destination=EcuMWakeupSource  # Reference to a wakeup source in the EcuM configuration. This reference is only needed if LinTrcvWakeupByBusUsed is true. Implementation Type: reference to EcuM_WakeupSourceType.
      choice container LinTrcvAccess  # Container gives LIN transceiver driver access about a single LIN transceiver channel.
        container LinTrcvDioAccess [0..1]  # Container gives LIN transceiver driver information about accessing ports and port pins. In addition relation between LIN transceiver hardware pin names and Dio port access information is given. If a LIN transceiver hardware has no Dio interface, there is no instance of this container.
          container LinTrcvDioChannelAccess [1..*]  # Container gives DIO channel access by single Lin transceiver channel.
            string LinTrcvHardwareInterfaceName: set at pre-compile  # LIN transceiver hardware interface name. It is typically the name of a pin. From a Dio point of view it is either a port, a single channel or a channel group. Depending on this fact either LINTRCV_DIO_PORT_SYMBOLIC_NAME or LINTRCV_DIO_CHANNEL_SYMBOLIC_NAME or LINTRCV_DIO_CHANNEL_GROUP_SYMBOLIC_NAME shall reference a Dio configuration. The LIN transceiver driver implementation description shall list up this name for the appropriate LIN transceiver hardware.
            choice reference LinTrcvDioSymRefName: set at pre-compile, destination=[DioChannel, DioChannelGroup, DioPort]  # Choice Reference to a DIO Port, DIO Channel or DIO Channel Group. This reference replaces the LINTRCV_DIO_PORT_SYM_NAME, LINTRCV_DIO_CHANNEL_SYM_NAME and LINTRCV_DIO_GROUP_SYM_NAME references in the Lin Trcv SWS.
        container LinTrcvSpiSequence [0..1]  # Container gives LIN transceiver driver information about one SPI sequence. | One SPI sequence used by LIN transceiver driver is in exclusive use for it. No other driver is allowed to access this sequence. LIN transceiver driver may use one sequence to access n LIN transceiver hardwares chips of the same type or n sequences are used to access one single LIN transceiver hardware chip. If a LIN transceiver hardware has no SPI interface, there is no instance of this container.
          reference LinTrcvSpiSequenceName: set at pre-compile, requires-symbolic-name-value=true, destination=SpiSequence  # Reference to a Spi sequence configuration container.
    container LinTrcvGeneral  # Container gives LIN transceiver driver basic information.
      boolean LinTrcvDevErrorDetect: set at pre-compile, default-value=false  # Switches the development error detection and notification on or off. | * true: detection and notification is enabled. * false: detection and notification is disabled.
      integer LinTrcvIndex: 0..255, set at pre-compile  # Specifies the InstanceId of this module instance. If only one instance is present it shall have the Id 0.
      enumeration LinTrcvTimerType [0..1]: {None, Timer_1us16bit}, multiplicity set at pre-compile, set at pre-compile  # Type of the Time Service Predefined Timer.
      boolean LinTrcvVersionInfoApi: set at pre-compile, default-value=false  # Switches version information API on and off. If switched off, function need not be present in compiled code. | True: Is used False: Is not used
      float LinTrcvWaitTime [0..1]: 0..2.55E-4, multiplicity set at pre-compile, set at pre-compile  # Wait time for transceiver state changes in seconds.
      boolean LinTrcvWakeUpSupport: set at pre-compile  # Informs whether wake up is supported or not. In case wake up is not supported by LIN transceiver hardware the setting shall be false. The wake up ability may be switched on or off for each channel of one LIN transceiver by LinTrcvWakeupSourceRef. | True: Is used False: Is not used
      reference LinTrcvEcucPartitionRef [0..*]: scope=ECU, multiplicity set at pre-compile, post-build-variant-multiplicity=true, post-build-variant-value=true, set at pre-compile, destination=EcucPartition  # Maps the Lin transceiver driver to zero or multiple ECUC partitions to make the modules API available in this partition. The Lin transceiver driver will operate as an independent instance in each of the partitions. Tags: atp.Status=draft
  module definition Mcu [0..1]: post-build-variant-support=true, variants post-build/pre-compile  # Configuration of the Mcu (Microcontroller Unit) module.
    container McuGeneralConfiguration  # This container contains the configuration (parameters) of the MCU driver.
      boolean McuDevErrorDetect: set at pre-compile, default-value=false  # Switches the development error detection and notification on or off. | * true: detection and notification is enabled. * false: detection and notification is disabled.
      boolean McuGetRamStateApi: set at pre-compile  # Pre-processor switch to enable/disable the API Mcu_GetRamState. | (e.g. If the H/W does not support the functionality, this parameter can be used to disable the Api).
      boolean McuInitClock: set at pre-compile, default-value=true  # If this parameter is set to FALSE, the clock initialization has to be disabled from the MCU driver. This concept applies when there are some write once clock registers and a bootloader is present. If this parameter is set to TRUE, the MCU driver is responsible of the clock initialization.
      boolean McuNoPll: set at pre-compile, default-value=true  # This parameter shall be set True, if the H/W does not have a PLL or the PLL circuitry is enabled after the power on without S/W intervention. In this case MCU_DistributePllClock has to be disabled and MCU_GetPllStatus has to return MCU_PLL_STATUS_UNDEFINED. Otherwise this parameters has to be set False
      boolean McuPerformResetApi: set at pre-compile  # Pre-processor switch to enable / disable the use of the function Mcu_PerformReset()
      boolean McuVersionInfoApi: set at pre-compile, default-value=false  # Pre-processor switch to enable / disable the API to read out the modules version information.
      reference McuEcucPartitionRef [0..*]: scope=ECU, multiplicity set at pre-compile, post-build-variant-multiplicity=true, post-build-variant-value=true, set at pre-compile, destination=EcucPartition  # Maps the MCU driver to zero or multiple ECUC partition to make the driver API available in this partition. Tags: atp.Status=draft
    container McuModuleConfiguration  # This container contains the configuration (parameters) of the MCU driver
      enumeration McuClockSrcFailureNotification: {DISABLED, ENABLED}, post-build-variant-value=true, set at post-build in variant post-build / pre-compile in variant pre-compile  # Enables/Disables clock failure notification. In case this feature is not supported by HW the setting should be disabled.
      integer McuNumberOfMcuModes: 1..255, post-build-variant-value=true, set at post-build in variant post-build / pre-compile in variant pre-compile  # This parameter shall represent the number of Modes available for the MCU. | calculationFormula = Number of configured McuModeSettingConf
      integer McuRamSectors: 0..4294967295, post-build-variant-value=true, set at post-build in variant post-build / pre-compile in variant pre-compile  # This parameter shall represent the number of RAM sectors available for the MCU. | calculationFormula = Number of configured McuRamSectorSettingConf
      integer McuResetSetting [0..1]: 1..255, multiplicity set at pre-compile, set at pre-compile  # This parameter relates to the MCU specific reset configuration. This applies to the function Mcu_PerformReset, which performs a microcontroller reset using the hardware feature of the microcontroller.
      container McuClockSettingConfig [1..*]  # This container contains the configuration (parameters) for the Clock settings of the MCU. Please see MCU031 for more information on the MCU clock settings.
        integer McuClockSettingId: 0..255, set at pre-compile, symbolic-name-value=true  # The Id of this McuClockSettingConfig to be used as argument for the API call "Mcu_InitClock".
        container McuClockReferencePoint [1..*]  # This container defines a reference point in the Mcu Clock tree. It defines the frequency which then can be used by other modules as an input value. Lower multiplicity is 1, as even in the simplest case (only one frequency is used), there is one frequency to be defined.
          float McuClockReferencePointFrequency: 0..Inf, scope=ECU, post-build-variant-value=true, set at post-build in variant post-build / pre-compile in variant pre-compile  # This is the frequency for the specific instance of the McuClockReferencePoint container. It shall be given in Hz.
      container McuDemEventParameterRefs [0..1]  # Container for the references to DemEventParameter elements which shall be invoked using the API Dem_SetEventStatus in case the corresponding error occurs. The EventId is taken from the referenced DemEventParameter's DemEventId symbolic value. The standardized errors are provided in this container and can be extended by vendor-specific error references.
        reference MCU_E_CLOCK_FAILURE [0..1]: multiplicity set at pre-compile, set at pre-compile, requires-symbolic-name-value=true, destination=DemEventParameter  # Reference to configured DEM event to report "Clock source failure".
      container McuModeSettingConf [1..*]  # This container contains the configuration (parameters) for the Mode setting of the MCU. Please see MCU035 for more information on the MCU mode settings.
        integer McuMode: 0..255, set at pre-compile, symbolic-name-value=true  # The parameter represents the MCU Mode settings.
      container McuRamSectorSettingConf [0..*]  # This container contains the configuration (parameters) for the RAM Sector setting. Please see MCU030 for more information on RAM sec-tor settings.
        integer McuRamDefaultValue: 0..255, post-build-variant-value=true, set at post-build in variant post-build / pre-compile in variant pre-compile  # This parameter shall represent the Data pre-setting to be initialized
        integer McuRamSectionBaseAddress: 0..4294967295, post-build-variant-value=true, set at post-build in variant post-build / pre-compile in variant pre-compile  # This parameter shall represent the MCU RAM section base address
        integer McuRamSectionSize: 0..4294967295, post-build-variant-value=true, set at post-build in variant post-build / pre-compile in variant pre-compile  # This parameter represents the MCU RAM Section size in bytes.
        integer McuRamSectionWriteSize: 0..4294967295, post-build-variant-value=true, set at post-build in variant post-build / pre-compile in variant pre-compile, default-value=8  # This parameter shall define the size in bytes of data which can be written into RAM at once.
    container McuPublishedInformation  # Container holding all MCU specific published information parameters
      container McuResetReasonConf [1..*]  # This container contains the configuration for the different type of reset reason that can be retrieved from Mcu_GetResetReason Api.
        integer McuResetReason: 0..255, scope=ECU, set at published-information, symbolic-name-value=true  # The parameter represents the different type of reset that a Micro supports. This parameter is referenced by the parameter EcuMResetReason in the ECU State manager module.
  module definition MemIf [0..1]: variants pre-compile  # Configuration of the MemIf (Memory Abstraction Interface) module.
    container MemIfGeneral  # Configuration of the memory abstraction interface (Memif) module.
      boolean MemIfDevErrorDetect: set at pre-compile, default-value=false  # Switches the development error detection and notification on or off. | * true: detection and notification is enabled. * false: detection and notification is disabled.
      integer MemIfNumberOfDevices: 1..2, set at pre-compile  # Concrete number of underlying memory abstraction modules. | Calculation Formula: Count number of configured EA and FEE modules.
      boolean MemIfVersionInfoApi: set at pre-compile, default-value=false  # Pre-processor switch to enable / disable the API to read out the modules version information. | true: Version info API enabled. false: Version info API disabled.
  module definition MemMap [0..1]: variants pre-compile  # Configuration of the Memory Mapping and Compiler Abstraction module.
    container MemMapAddressingModeSet [0..*]  # Defines a set of addressing modes which might apply to a SwAddrMethod.
      string MemMapCompilerMemClassSymbolImpl: scope=ECU, set at pre-compile  # Defines the implementation behind a MemClassSymbol and configures the Compiler Abstraction.
      string MemMapSupportedAddressingMethodOption [0..*]: scope=ECU, multiplicity set at pre-compile, set at pre-compile, regular-expression=[a-zA-Z]([a-zA-Z0-9]|_[a-zA-Z0-9])*_?  # This constrains the usage of this addressing mode set for Generic Mappings to swAddrMethods. | The attribute option of a swAddrMethod mapped via MemMapGenericMapping to this MemMapAddressingModeSet shall be equal to one of the configured MemMapSupportedAddressMethodOption's
      enumeration MemMapSupportedMemoryAllocationKeywordPolicy [0..*]: {MEMMAP_ALLOCATION_KEYWORD_POLICY_ADDR_METHOD_SHORT_NAME, MEMMAP_ALLOCATION_KEYWORD_POLICY_ADDR_METHOD_SHORT_NAME_AND_ALIGNMENT}, scope=ECU, multiplicity set at pre-compile, set at pre-compile  # This constrains the usage of this addressing mode set for Generic Mappings to swAddrMethods. | The attribute MemoryAllocationKeywordPolicy of a swAddrMethod mapped via MemMapGenericMapping to this MemMapAddressingModeSet shall be equal to one of the configured MemMapSupportedMemoryAllocationKeywordPolicy's
      string MemMapSupportedSectionInitializationPolicy [0..*]: scope=ECU, multiplicity set at pre-compile, set at pre-compile  # This constrains the usage of this addressing mode set for Generic Mappings to swAddrMethods. | The sectionIntializationPolicy attribute value of a swAddrMethod mapped via MemMapGenericMapping to this MemMapAddressingModeSet shall be equal to one of the configured MemMapSupportedSectionIntializationPolicy's Please note that SectionInitializationPolicyType describes the intended initialization of MemorySections. The following values are standardized in AUTOSAR Methodology: * '''NO-INIT''': No initialization and no clearing is performed. Such data elements must not be read before one has written a value into it. * '''INIT''': To be used for data that are initialized by every reset to the specified value (initValue). * '''POWER-ON-INIT''': To be used for data that are initialized by "Power On" to the specified value (initValue). Note: there might be several resets between power on resets. * '''CLEARED''': To be used for data that are initialized by every reset to zero. * '''POWER-ON-CLEARED''': To be used for data that are initialized by "Power On" to zero. Note: there might be several resets between power on resets. Please note that the values are defined similar to the representation of enumeration types in the XML schema to ensure backward compatibility.
      enumeration MemMapSupportedSectionType [0..*]: {MEMMAP_SECTION_TYPE_CAL_PRM, MEMMAP_SECTION_TYPE_CODE, MEMMAP_SECTION_TYPE_CONFIG_DATA, MEMMAP_SECTION_TYPE_CONST, MEMMAP_SECTION_TYPE_EXCLUDE_FROM_FLASH, MEMMAP_SECTION_TYPE_VAR}, scope=ECU, multiplicity set at pre-compile, set at pre-compile  # This constrains the usage of this addressing mode set for Generic Mappings to swAddrMethods. | The attribute sectionType of a swAddrMethod mapped via MemMapGenericMapping or MemMapSectionSpecificMapping to this MemMapAddressingModeSet shall be equal to one of the configured MemMapSupportedSectionType's.
      container MemMapAddressingMode [1..*]  # Defines a addressing mode with a set of #pragma statements implementing the start and the stop of a section.
        multiline string MemMapAddressingModeStart: set at pre-compile  # Defines a set of #pragma statements implementing the start of a section.
        multiline string MemMapAddressingModeStop: set at pre-compile  # Defines a set of #pragma statements implementing the start of a section.
        string MemMapAlignmentSelector [1..*]: multiplicity set at pre-compile, set at pre-compile, regular-expression=[1-9][0-9]*|0x[0-9a-f]*|0[0-7]*|0b[0-1]*|UNSPECIFIED|UNKNOWN|BOOLEAN|PTR  # Defines a the alignments for which the MemMapAddressingMode applies. | The to be used alignment is defined in the alignment attribute of the MemorySection. If the MemMapAlignmentSelector fits to alignment attribute of the MemorySection the set of #pragmas of the related MemMapAddressingMode shall be used to implement the start and the stop of a section. Please note that the same MemMapAddressingMode can be applicable for several alignments, e.g. "8" bit and "UNSPECIFIED".
    container MemMapAllocation [0..*]  # Defines which MemorySection of a BSW Module or a Software Component is implemented with which MemMapAddressingModeSet. | This can either be specified for a set of MemorySections which refer to an identical SwAddrMethod (MemMapGenericMapping) or for individual MemorySections (MemMapSectionSpecificMapping). If both are defined for the same MemorySection the MemMapSectionSpecificMapping overrules the MemMapGenericMapping.
      container MemMapGenericMapping [0..*]  # Defines which SwAddrMethod is implemented with which MemMapAddressingModeSet. | The pragmas for the implementation of the MemorySelectorKeywords are taken from the MemMapAddressingModeStart and MemMapAddressingModeStop parameters of the MemMapAddressingModeSet for the individual alignments. That this mapping becomes valid requires matching MemMapSupportedSectionType's, MemMapSupportedSectionInitializationPolicy's and MemMapSupportedAddressingMethodOption's. The MemMapGenericMapping applies only if it is not overruled by an MemMapSectionSpecificMapping
        reference MemMapAddressingModeSetRef: scope=ECU, set at pre-compile, destination=MemMapAddressingModeSet  # Reference to the MemMapAddressingModeSet which applies to the MemMapGenericMapping.
        reference MemMapMappingSelectorRef [0..1]: scope=ECU, set at pre-compile, destination=MemMapMappingSelector  # Reference to a MemMapPrefixSelector. The owning MemMapGenericMapping is only effective for those memories where the MemMapMappingSelector matches.
        foreign reference MemMapSwAddressMethodRef: scope=ECU, set at pre-compile, destination-type=SW-ADDR-METHOD  # Reference to the SwAddrMethod which applies to the MemMapGenericMapping.
      container MemMapMappingSelector [0..*]  # The container holds a section criteria reusable for MemMapGenericMappings.
        string MemMapPrefixSelector [0..1]: scope=ECU, set at pre-compile  # The parameter MemMapPrefixSelector defines a regular expression which shall be applied to the <PREFIX> part of the memory allocation keywords. | The mapping using this selector is only effective for those memories where the <PREFIX> part of the memory allocation keyword matches the regular expression. Note: This is in particular intended the restrict the usage of of a MemMapAddressingModeSet for a sub set of BSW Modules or Software Components or a subset of allocatable memory parts inside BSW Modules or Software Components.
      container MemMapSectionSpecificMapping [0..*]  # Defines which MemorySection of a BSW Module or a Software Component is implemented with which MemMapAddressingModeSet. | The pragmas for the implementation of the MemorySelectorKeywords are taken from the MemMapAddressingModeStart and MemMapAddressingModeStop parameters of the MemMapAddressingModeSet for the specific alignment of the MemorySection. The MemMapSectionSpecificMapping precedes a mapping defined by MemMapGenericMapping.
        reference MemMapAddressingModeSetRef: scope=ECU, set at pre-compile, destination=MemMapAddressingModeSet  # Reference to the MemMapAddressingModeSet which applies to the MemMapModuleSectionSpecificMapping.
        foreign reference MemMapMemorySectionRef: scope=ECU, set at pre-compile, destination-type=MEMORY-SECTION  # Reference to the MemorySection which applies to the MemMapSectionSpecificMapping.
    container MemMapGenericCompilerMemClass [0..*]  # The shortName of the container defines the name of the generic Compiler memclass which is global for all using modules, e.g. REGSPACE. | The configures the Compiler Abstraction.
      string MemMapGenericCompilerMemClassSymbolImpl: scope=ECU, set at pre-compile  # Defines the implementation behind the generic MemClassSymbol and configures the Compiler Abstraction.
  module definition Mirror [0..1]: post-build-variant-support=true, variants link-time/post-build/pre-compile  # Configuration of the Bus Mirroring module.
    container MirrorConfigSet  # Contains the configuration parameters and sub containers of the Bus Mirroring module.
      reference MirrorInitialDestNetworkRef: post-build-variant-value=true, set at link in variant link-time / post-build in variant post-build / pre-compile in variant pre-compile, destination=MirrorDestNetwork  # Reference to the destination bus that is selected after initialization of the Bus Mirroring module.
      choice container MirrorDestNetwork [1..*]: multiplicity set at link in variant link-time / post-build in variant post-build / pre-compile in variant pre-compile, post-build-variant-multiplicity=true  # Destination bus to which frames are sent by the Bus Mirroring module.
        container MirrorDestNetworkCan [0..1]: multiplicity set at link in variant link-time / post-build in variant post-build / pre-compile in variant pre-compile, post-build-variant-multiplicity=true  # Destination bus representing a CAN network.
          integer MirrorDestQueueSize: 1..65535, set at link in variant link-time+post-build / pre-compile in variant pre-compile, default-value=20  # Number of frames that can be stored in the output queue for the destination bus.
          integer MirrorNetworkId: 0..255, scope=ECU, post-build-variant-value=true, set at link in variant link-time / post-build in variant post-build / pre-compile in variant pre-compile, symbolic-name-value=true  # Network ID of the bus.
          integer MirrorStatusCanId [0..1]: 0..4294967295, post-build-variant-value=true, set at link in variant link-time / post-build in variant post-build / pre-compile in variant pre-compile  # CAN ID of the CAN status frame. | If configured, a status frame will be sent on the CAN destination bus that contains the state of all active source buses.
          reference MirrorComMNetworkHandleRef: set at link in variant link-time / post-build in variant post-build / pre-compile in variant pre-compile, requires-symbolic-name-value=true, destination=ComMChannel  # Reference to the ComMChannel that represents the bus.
          container MirrorDestPdu [1..*]: multiplicity set at link in variant link-time / post-build in variant post-build / pre-compile in variant pre-compile, post-build-variant-multiplicity=true  # I-PDU used for transmission of the mirrored frames on the destination bus. | For FlexRay, an arbitrary number of I-PDUs can be configured. For the other bus types, only one I-PDU is supported per destination bus.
            integer MirrorDestPduId: 0..65535, scope=ECU, set at pre-compile, symbolic-name-value=true  # I-PDU identifier used for TxConfirmation from PduR.
            boolean MirrorDestPduUsesTriggerTransmit: post-build-variant-value=true, set at link in variant link-time / post-build in variant post-build / pre-compile in variant pre-compile  # Switches transmission via TriggerTransmit. | * true: The I-PDU is transmitted using TriggerTransmit. * false: The I-PDU is transmitted directly with the Transmit call.
            reference MirrorDestPduRef: set at link in variant link-time+post-build / pre-compile in variant pre-compile, destination=Pdu  # Reference to the Pdu object representing the I-PDU.
        container MirrorDestNetworkCdd [0..1]: multiplicity set at link in variant link-time / post-build in variant post-build / pre-compile in variant pre-compile, post-build-variant-multiplicity=true  # Destination bus representing a user defined network.
          integer MirrorDestQueueSize: 1..65535, set at link in variant link-time+post-build / pre-compile in variant pre-compile, default-value=20  # Number of frames that can be stored in the output queue for the destination bus.
          float MirrorDestTransmissionDeadline [0..1]: 0.001..0.655, post-build-variant-value=true, set at link in variant link-time / post-build in variant post-build / pre-compile in variant pre-compile, default-value=0.1  # Time in seconds after which the collection of source frames into the destination frame stopped and the frame is sent at the latest. | If omitted, destination frames are only sent when full or when the time stamp overflows after 655.35ms.
          integer MirrorNetworkId: 0..255, scope=ECU, post-build-variant-value=true, set at link in variant link-time / post-build in variant post-build / pre-compile in variant pre-compile, symbolic-name-value=true  # Network ID of the bus.
          reference MirrorComMNetworkHandleRef: set at link in variant link-time / post-build in variant post-build / pre-compile in variant pre-compile, requires-symbolic-name-value=true, destination=ComMChannel  # Reference to the ComMChannel that represents the bus.
          container MirrorDestPdu [1..*]: multiplicity set at link in variant link-time / post-build in variant post-build / pre-compile in variant pre-compile, post-build-variant-multiplicity=true  # I-PDU used for transmission of the mirrored frames on the destination bus. | For FlexRay, an arbitrary number of I-PDUs can be configured. For the other bus types, only one I-PDU is supported per destination bus.
            integer MirrorDestPduId: 0..65535, scope=ECU, set at pre-compile, symbolic-name-value=true  # I-PDU identifier used for TxConfirmation from PduR.
            boolean MirrorDestPduUsesTriggerTransmit: post-build-variant-value=true, set at link in variant link-time / post-build in variant post-build / pre-compile in variant pre-compile  # Switches transmission via TriggerTransmit. | * true: The I-PDU is transmitted using TriggerTransmit. * false: The I-PDU is transmitted directly with the Transmit call.
            reference MirrorDestPduRef: set at link in variant link-time+post-build / pre-compile in variant pre-compile, destination=Pdu  # Reference to the Pdu object representing the I-PDU.
        container MirrorDestNetworkFlexRay [0..1]: multiplicity set at link in variant link-time / post-build in variant post-build / pre-compile in variant pre-compile, post-build-variant-multiplicity=true  # Destination bus representing a FlexRay network.
          integer MirrorDestQueueSize: 1..65535, set at link in variant link-time+post-build / pre-compile in variant pre-compile, default-value=20  # Number of frames that can be stored in the output queue for the destination bus.
          float MirrorDestTransmissionDeadline [0..1]: 0.001..0.655, post-build-variant-value=true, set at link in variant link-time / post-build in variant post-build / pre-compile in variant pre-compile, default-value=0.1  # Time in seconds after which the collection of source frames into the destination frame stopped and the frame is sent at the latest. | If omitted, destination frames are only sent when full or when the time stamp overflows after 655.35ms.
          integer MirrorNetworkId: 0..255, scope=ECU, post-build-variant-value=true, set at link in variant link-time / post-build in variant post-build / pre-compile in variant pre-compile, symbolic-name-value=true  # Network ID of the bus.
          reference MirrorComMNetworkHandleRef: set at link in variant link-time / post-build in variant post-build / pre-compile in variant pre-compile, requires-symbolic-name-value=true, destination=ComMChannel  # Reference to the ComMChannel that represents the bus.
          container MirrorDestPdu [1..*]: multiplicity set at link in variant link-time / post-build in variant post-build / pre-compile in variant pre-compile, post-build-variant-multiplicity=true  # I-PDU used for transmission of the mirrored frames on the destination bus. | For FlexRay, an arbitrary number of I-PDUs can be configured. For the other bus types, only one I-PDU is supported per destination bus.
            integer MirrorDestPduId: 0..65535, scope=ECU, set at pre-compile, symbolic-name-value=true  # I-PDU identifier used for TxConfirmation from PduR.
            boolean MirrorDestPduUsesTriggerTransmit: post-build-variant-value=true, set at link in variant link-time / post-build in variant post-build / pre-compile in variant pre-compile  # Switches transmission via TriggerTransmit. | * true: The I-PDU is transmitted using TriggerTransmit. * false: The I-PDU is transmitted directly with the Transmit call.
            reference MirrorDestPduRef: set at link in variant link-time+post-build / pre-compile in variant pre-compile, destination=Pdu  # Reference to the Pdu object representing the I-PDU.
        container MirrorDestNetworkIp [0..1]: multiplicity set at link in variant link-time / post-build in variant post-build / pre-compile in variant pre-compile, post-build-variant-multiplicity=true  # Destination bus representing an IP network.
          integer MirrorDestQueueSize: 1..65535, set at link in variant link-time+post-build / pre-compile in variant pre-compile, default-value=20  # Number of frames that can be stored in the output queue for the destination bus.
          float MirrorDestTransmissionDeadline [0..1]: 0.001..0.655, post-build-variant-value=true, set at link in variant link-time / post-build in variant post-build / pre-compile in variant pre-compile, default-value=0.1  # Time in seconds after which the collection of source frames into the destination frame stopped and the frame is sent at the latest. | If omitted, destination frames are only sent when full or when the time stamp overflows after 655.35ms.
          integer MirrorNetworkId: 0..255, scope=ECU, post-build-variant-value=true, set at link in variant link-time / post-build in variant post-build / pre-compile in variant pre-compile, symbolic-name-value=true  # Network ID of the bus.
          reference MirrorComMNetworkHandleRef: set at link in variant link-time / post-build in variant post-build / pre-compile in variant pre-compile, requires-symbolic-name-value=true, destination=ComMChannel  # Reference to the ComMChannel that represents the bus.
          container MirrorDestPdu [1..*]: multiplicity set at link in variant link-time / post-build in variant post-build / pre-compile in variant pre-compile, post-build-variant-multiplicity=true  # I-PDU used for transmission of the mirrored frames on the destination bus. | For FlexRay, an arbitrary number of I-PDUs can be configured. For the other bus types, only one I-PDU is supported per destination bus.
            integer MirrorDestPduId: 0..65535, scope=ECU, set at pre-compile, symbolic-name-value=true  # I-PDU identifier used for TxConfirmation from PduR.
            boolean MirrorDestPduUsesTriggerTransmit: post-build-variant-value=true, set at link in variant link-time / post-build in variant post-build / pre-compile in variant pre-compile  # Switches transmission via TriggerTransmit. | * true: The I-PDU is transmitted using TriggerTransmit. * false: The I-PDU is transmitted directly with the Transmit call.
            reference MirrorDestPduRef: set at link in variant link-time+post-build / pre-compile in variant pre-compile, destination=Pdu  # Reference to the Pdu object representing the I-PDU.
      choice container MirrorSourceNetwork [1..*]: multiplicity set at link in variant link-time / post-build in variant post-build / pre-compile in variant pre-compile, post-build-variant-multiplicity=true  # Source bus from which frames are received by the Bus Mirroring module.
        container MirrorSourceNetworkCan [0..1]: multiplicity set at link in variant link-time / post-build in variant post-build / pre-compile in variant pre-compile, post-build-variant-multiplicity=true  # Source bus representing a CAN network.
          integer MirrorNetworkId: 0..255, scope=ECU, post-build-variant-value=true, set at link in variant link-time / post-build in variant post-build / pre-compile in variant pre-compile, symbolic-name-value=true  # Network ID of the bus.
          integer MirrorSourceMaxDynamicFilters: 0..255, set at link in variant link-time+post-build / pre-compile in variant pre-compile, default-value=5  # Maximum number of filters that can be dynamically added using Mirror_AddXxxFilter().
          reference MirrorComMNetworkHandleRef: set at link in variant link-time / post-build in variant post-build / pre-compile in variant pre-compile, requires-symbolic-name-value=true, destination=ComMChannel  # Reference to the ComMChannel that represents the bus.
          choice container MirrorSourceCanFilter [0..255]: multiplicity set at link in variant link-time / post-build in variant post-build / pre-compile in variant pre-compile, post-build-variant-multiplicity=true  # Pre-configured filter for CAN frames.
            container MirrorSourceCanFilterMask [0..1]: multiplicity set at link in variant link-time / post-build in variant post-build / pre-compile in variant pre-compile, post-build-variant-multiplicity=true  # Pre-configured mask based filter for CAN frames.
              integer MirrorSourceCanFilterCanIdCode: 0..4294967295, post-build-variant-value=true, set at link in variant link-time / post-build in variant post-build / pre-compile in variant pre-compile  # Value to match masked CAN IDs.
              integer MirrorSourceCanFilterCanIdMask: 0..4294967295, post-build-variant-value=true, set at link in variant link-time / post-build in variant post-build / pre-compile in variant pre-compile  # Mask applied to CAN IDs before comparison.
              integer MirrorSourceCanFilterId: 0..255, scope=ECU, post-build-variant-value=true, set at link in variant link-time / post-build in variant post-build / pre-compile in variant pre-compile, symbolic-name-value=true  # Unique identifier of the pre-configured CAN filter.
            container MirrorSourceCanFilterRange [0..1]: multiplicity set at link in variant link-time / post-build in variant post-build / pre-compile in variant pre-compile, post-build-variant-multiplicity=true  # Pre-configured range filter for CAN frames.
              integer MirrorSourceCanFilterId: 0..255, scope=ECU, post-build-variant-value=true, set at link in variant link-time / post-build in variant post-build / pre-compile in variant pre-compile, symbolic-name-value=true  # Unique identifier of the pre-configured CAN filter.
              integer MirrorSourceCanFilterLower: 0..4294967295, post-build-variant-value=true, set at link in variant link-time / post-build in variant post-build / pre-compile in variant pre-compile  # Lowest CAN ID that is accepted by the filter.
              integer MirrorSourceCanFilterUpper: 0..4294967295, post-build-variant-value=true, set at link in variant link-time / post-build in variant post-build / pre-compile in variant pre-compile  # Highest CAN ID that is accepted by the filter.
          container MirrorSourceCanMaskBasedIdMapping [0..*]: multiplicity set at link in variant link-time / post-build in variant post-build / pre-compile in variant pre-compile, post-build-variant-multiplicity=true  # Rule for remapping a set of CAN IDs.
            integer MirrorSourceCanMaskBasedIdMappingDestBaseId: 0..4294967295, post-build-variant-value=true, set at link in variant link-time / post-build in variant post-build / pre-compile in variant pre-compile  # Base ID merged with the masked parts of the original CAN ID to form the mapped CAN ID.
            integer MirrorSourceCanMaskBasedIdMappingSourceCanIdCode: 0..4294967295, post-build-variant-value=true, set at link in variant link-time / post-build in variant post-build / pre-compile in variant pre-compile  # Value to match masked original CAN IDs.
            integer MirrorSourceCanMaskBasedIdMappingSourceCanIdMask: 0..4294967295, post-build-variant-value=true, set at link in variant link-time / post-build in variant post-build / pre-compile in variant pre-compile  # Mask applied to original CAN IDs before comparison.
          container MirrorSourceCanSingleIdMapping [0..*]: multiplicity set at link in variant link-time / post-build in variant post-build / pre-compile in variant pre-compile, post-build-variant-multiplicity=true  # Rule for remapping a single CAN ID.
            integer MirrorSourceCanSingleIdMappingDestCanId: 0..4294967295, post-build-variant-value=true, set at link in variant link-time / post-build in variant post-build / pre-compile in variant pre-compile  # Mapped CAN ID.
            integer MirrorSourceCanSingleIdMappingSourceCanId: 0..4294967295, post-build-variant-value=true, set at link in variant link-time / post-build in variant post-build / pre-compile in variant pre-compile  # Original CAN ID.
        container MirrorSourceNetworkFlexRay [0..1]: multiplicity set at link in variant link-time / post-build in variant post-build / pre-compile in variant pre-compile, post-build-variant-multiplicity=true  # Source bus representing a FlexRay network.
          integer MirrorNetworkId: 0..255, scope=ECU, post-build-variant-value=true, set at link in variant link-time / post-build in variant post-build / pre-compile in variant pre-compile, symbolic-name-value=true  # Network ID of the bus.
          integer MirrorSourceMaxDynamicFilters: 0..255, set at link in variant link-time+post-build / pre-compile in variant pre-compile, default-value=5  # Maximum number of filters that can be dynamically added using Mirror_AddXxxFilter().
          reference MirrorComMNetworkHandleRef: set at link in variant link-time / post-build in variant post-build / pre-compile in variant pre-compile, requires-symbolic-name-value=true, destination=ComMChannel  # Reference to the ComMChannel that represents the bus.
          container MirrorSourceFlexRayFilter [0..255]: multiplicity set at link in variant link-time / post-build in variant post-build / pre-compile in variant pre-compile, post-build-variant-multiplicity=true  # Pre-configured filter for FlexRay frames.
            enumeration MirrorSourceFlexRayFilterChannelAssignment: {MIRROR_FR_CHANNEL_A, MIRROR_FR_CHANNEL_AB, MIRROR_FR_CHANNEL_B}, post-build-variant-value=true, set at link in variant link-time / post-build in variant post-build / pre-compile in variant pre-compile  # FlexRay channels accepted by the filter.
            integer MirrorSourceFlexRayFilterCycleRepetition: 1..64, post-build-variant-value=true, set at link in variant link-time / post-build in variant post-build / pre-compile in variant pre-compile  # Cycle repetition of accepted cycles.
            integer MirrorSourceFlexRayFilterId: 0..255, scope=ECU, post-build-variant-value=true, set at link in variant link-time / post-build in variant post-build / pre-compile in variant pre-compile, symbolic-name-value=true  # Unique identifier of the pre-configured FlexRay filter.
            integer MirrorSourceFlexRayFilterLowerBaseCycle: 0..63, post-build-variant-value=true, set at link in variant link-time / post-build in variant post-build / pre-compile in variant pre-compile  # Lowest base cycle number that is accepted by the filter.
            integer MirrorSourceFlexRayFilterLowerSlot: 1..2047, post-build-variant-value=true, set at link in variant link-time / post-build in variant post-build / pre-compile in variant pre-compile  # Lowest slot ID that is accepted by the filter.
            integer MirrorSourceFlexRayFilterUpperBaseCycle: 0..63, post-build-variant-value=true, set at link in variant link-time / post-build in variant post-build / pre-compile in variant pre-compile  # Highest base cycle number that is accepted by the filter.
            integer MirrorSourceFlexRayFilterUpperSlot: 1..2047, post-build-variant-value=true, set at link in variant link-time / post-build in variant post-build / pre-compile in variant pre-compile  # Highest slot ID that is accepted by the filter.
        container MirrorSourceNetworkLin [0..1]: multiplicity set at link in variant link-time / post-build in variant post-build / pre-compile in variant pre-compile, post-build-variant-multiplicity=true  # Source bus representing a LIN network.
          integer MirrorNetworkId: 0..255, scope=ECU, post-build-variant-value=true, set at link in variant link-time / post-build in variant post-build / pre-compile in variant pre-compile, symbolic-name-value=true  # Network ID of the bus.
          integer MirrorSourceLinToCanBaseId: 0..4294967295, post-build-variant-value=true, set at link in variant link-time / post-build in variant post-build / pre-compile in variant pre-compile  # Base ID merged with the LIN frame ID to form the CAN ID.
          integer MirrorSourceMaxDynamicFilters: 0..255, set at link in variant link-time+post-build / pre-compile in variant pre-compile, default-value=5  # Maximum number of filters that can be dynamically added using Mirror_AddXxxFilter().
          reference MirrorComMNetworkHandleRef: set at link in variant link-time / post-build in variant post-build / pre-compile in variant pre-compile, requires-symbolic-name-value=true, destination=ComMChannel  # Reference to the ComMChannel that represents the bus.
          choice container MirrorSourceLinFilter [0..255]: multiplicity set at link in variant link-time / post-build in variant post-build / pre-compile in variant pre-compile, post-build-variant-multiplicity=true  # Pre-configured filter for LIN frames.
            container MirrorSourceLinFilterMask [0..1]: multiplicity set at link in variant link-time / post-build in variant post-build / pre-compile in variant pre-compile, post-build-variant-multiplicity=true  # Pre-configured mask based filter for LIN frames.
              integer MirrorSourceLinFilterId: 0..255, scope=ECU, post-build-variant-value=true, set at link in variant link-time / post-build in variant post-build / pre-compile in variant pre-compile, symbolic-name-value=true  # Unique identifier of the pre-configured LIN filter.
              integer MirrorSourceLinFilterLinIdCode: 0..63, post-build-variant-value=true, set at link in variant link-time / post-build in variant post-build / pre-compile in variant pre-compile  # Value to match masked frame IDs.
              integer MirrorSourceLinFilterLinIdMask: 0..63, post-build-variant-value=true, set at link in variant link-time / post-build in variant post-build / pre-compile in variant pre-compile  # Mask applied to frame IDs before comparison.
            container MirrorSourceLinFilterRange [0..1]: multiplicity set at link in variant link-time / post-build in variant post-build / pre-compile in variant pre-compile, post-build-variant-multiplicity=true  # Pre-configured range filter for LIN frames.
              integer MirrorSourceLinFilterId: 0..255, scope=ECU, post-build-variant-value=true, set at link in variant link-time / post-build in variant post-build / pre-compile in variant pre-compile, symbolic-name-value=true  # Unique identifier of the pre-configured LIN filter.
              integer MirrorSourceLinFilterLower: 0..63, post-build-variant-value=true, set at link in variant link-time / post-build in variant post-build / pre-compile in variant pre-compile  # Lowest frame ID that is accepted by the filter.
              integer MirrorSourceLinFilterUpper: 0..63, post-build-variant-value=true, set at link in variant link-time / post-build in variant post-build / pre-compile in variant pre-compile  # Highest frame ID that is accepted by the filter.
          container MirrorSourceLinToCanIdMapping [0..*]: multiplicity set at link in variant link-time / post-build in variant post-build / pre-compile in variant pre-compile, post-build-variant-multiplicity=true  # Rule for mapping a LIN frame ID to a special CAN ID.
            integer MirrorSourceLinToCanIdMappingCanId: 0..4294967295, post-build-variant-value=true, set at link in variant link-time / post-build in variant post-build / pre-compile in variant pre-compile  # CAN ID which lies outside of the range mapping.
            integer MirrorSourceLinToCanIdMappingLinId: 0..63, post-build-variant-value=true, set at link in variant link-time / post-build in variant post-build / pre-compile in variant pre-compile  # Frame ID which is excluded from the range mapping.
    container MirrorGeneral  # Contains the general configuration parameters of the module.
      boolean MirrorDevErrorDetect: set at pre-compile, default-value=false  # Switches the development error detection and notification on or off. | * true: detection and notification is enabled. * false: detection and notification is disabled.
      float MirrorMainFunctionPeriod: 0..Inf, set at link in variant link-time+post-build / pre-compile in variant pre-compile, default-value=0.05  # Execution cycle of Mirror_MainFunction() in seconds.
      boolean MirrorVersionInfoApi: set at pre-compile, default-value=false  # Pre-processor switch for enabling version info API support.
      reference MirrorStbRef [0..1]: set at pre-compile, requires-symbolic-name-value=true, destination=StbMSynchronizedTimeBase  # Reference to the StbM time base to use for acquiring the time stamps used in the mirroring protocol. | This reference is not required if all destination buses are CAN.
  module definition Nm [0..1]: variants link-time/pre-compile  # The Generic Network Management Interface module
    container NmChannelConfig [1..*]  # This container contains the configuration (parameters) of the bus channel(s). The channel parameter shall be harmonized within the whole communication stack.
      boolean NmActiveCoordinator [0..1]: multiplicity set at pre-compile, set at pre-compile  # This parameter indicates whether a NM channel - part of a Nm Coordination cluster - will be coordinated actively (NmActiveCoordinator = TRUE) or passively (NmActiveCoordinator = FALSE).
      boolean NmChannelSleepMaster: set at link in variant link-time / pre-compile in variant pre-compile  # This parameter shall be set to indicate if the sleep of this network can be absolutely decided by the local node only and that no other nodes can oppose that decision. | If this parameter is set to TRUE, the Nm shall assume that the channel is always ready to go to sleep and that no calls to Nm_RemoteSleepIndication or Nm_RemoteSleepCancellation will be made from the <BusNm> representing this channel. If this parameter is set to FALSE, the Nm shall not assume that the network is ready to sleep until a call has been made to Nm_RemoteSleepCancellation.
      boolean NmComUserDataSupport [0..1]: multiplicity set at pre-compile, set at pre-compile, default-value=false  # This parameter indicates whether on a NM channel user data is accessed via Com signals or by SetUserData API.
      integer NmCoordClusterIndex [0..1]: 0..255, multiplicity set at link in variant link-time / pre-compile in variant pre-compile, set at link in variant link-time / pre-compile in variant pre-compile  # If this parameter is undefined for a channel, the corresponding bus does not belong to an NM coordination cluster.
      boolean NmPassiveModeEnabled: set at pre-compile  # This parameter indicates whether a NM channel is active,e.g. can request communication and keep the bus awake, or passive, e.g. can just be woken up and kept awake by other ECUs.
      boolean NmStateReportEnabled: set at pre-compile  # Specifies if the NMS shall be set for the corresponding network. | false: No NMS shall be set true: The NMS shall be set
      boolean NmSynchronizingNetwork: set at link in variant link-time / pre-compile in variant pre-compile  # If this parameter is true, then this network is a synchronizing network for the NM coordination cluster which it belongs to. The network is expected to call Nm_SynchronizationPoint() at regular intervals.
      reference NmComMChannelRef: set at link in variant link-time / pre-compile in variant pre-compile, requires-symbolic-name-value=true, destination=ComMChannel  # Reference to the corresponding ComM Channel.
      reference NmStateReportSignalRef [0..1]: multiplicity set at pre-compile, set at pre-compile, requires-symbolic-name-value=true, destination=ComSignal  # Reference to the signal for setting the NMS by calling Com_SendSignal for the respective channel.
      choice container NmBusType
        container NmGenericBusNmConfig [0..1]
          string NmGenericBusNmPrefix: set at link in variant link-time / pre-compile in variant pre-compile  # The prefix which identifies the generic <BusNm>. This will be used to determine the API name to be called by Nm for the provided interfaces of the <BusNm>. This string will used for the module prefix before the "_" character in the API call name.
          float NmGenericBusNmShutdownTime: 0..Inf, set at link in variant link-time / pre-compile in variant pre-compile  # This parameter shall be | used to calculate shutdown delay time.
        container NmStandardBusNmConfig [0..1]
          enumeration NmStandardBusType: {NM_BUSNM_CANNM, NM_BUSNM_FRNM, NM_BUSNM_J1939NM, NM_BUSNM_LOCALNM, NM_BUSNM_UDPNM}, set at link in variant link-time / pre-compile in variant pre-compile  # Identifies the bus type of the channel for standard AUTOSAR <BusNm>s and is used to determine which set of API calls to be called by Nm for the <BusNm>s. | Note: The Ethernet bus' NM is UdpNm !
    container NmGlobalConfig  # This container contains all global configuration parameters of the Nm Interface.
      container NmGlobalConstants
        integer NmNumberOfChannels: 1..255, set at pre-compile  # Number of NM channels allowed within one ECU.
      container NmGlobalFeatures
        boolean NmBusSynchronizationEnabled: set at pre-compile  # Pre-processor switch for enabling bus synchronization support of the <BusNm>s. This feature is required for NM Coordinator nodes only.
        function name NmCarWakeUpCallout [0..1]: multiplicity set at link in variant link-time / pre-compile in variant pre-compile, set at link in variant link-time / pre-compile in variant pre-compile  # Name of the callout function to be called if Nm_CarWakeUpIndication() is called. If this parameter is not configured, the Nm will call BswM_Nm_CarWakeUpIndication.
        boolean NmCarWakeUpRxEnabled: set at link in variant link-time / pre-compile in variant pre-compile, default-value=false  # Enables or disables CWU detection. | FALSE - CarWakeUp not supported TRUE - CarWakeUp supported
        boolean NmComControlEnabled: set at pre-compile  # Pre-processor switch for enabling the Communication Control support.
        boolean NmCoordinatorSupportEnabled: set at pre-compile, default-value=false  # Pre-processor switch for enabling NM Coordinator support.
        boolean NmCoordinatorSyncSupport: set at link in variant link-time / pre-compile in variant pre-compile  # Enables/disables the coordinator synchronisation support.
        float NmGlobalCoordinatorTime [0..1]: 0..Inf, multiplicity set at pre-compile, set at pre-compile  # This parameter defines the maximum shutdown time of a connected and coordinated NM-Cluster. | Note:This includes nested connections.
        boolean NmPduRxIndicationEnabled: set at pre-compile  # Pre-processor switch for enabling the PDU Rx Indication.
        boolean NmRemoteSleepIndEnabled: set at pre-compile  # Pre-processor switch for enabling Remote Sleep Indication support. This feature is required for a Gateway or Nm Coordinator functionality. | Note that this feature should not be used if all NM channels have Passive Mode enabled.
        boolean NmStateChangeIndEnabled: set at pre-compile  # Pre-processor switch for enabling the Network Management state change notification.
        boolean NmUserDataEnabled: set at pre-compile  # Pre-processor switch for enabling User Data support.
      container NmGlobalProperties
        float NmCycletimeMainFunction [0..1]: 0..Inf, multiplicity set at link in variant link-time / pre-compile in variant pre-compile, set at link in variant link-time / pre-compile in variant pre-compile  # The period between successive calls to the Main Function of the NM Interface in seconds.
        boolean NmDevErrorDetect: set at pre-compile, default-value=false  # Switches the development error detection and notification on or off. | * true: detection and notification is enabled. * false: detection and notification is disabled.
        boolean NmVersionInfoApi: set at pre-compile, default-value=false  # Pre-processor switch for enabling Version Info API support.
  module definition NvM [0..1]: variants link-time/pre-compile  # Configuration of the NvM (NvRam Manager) module.
    container NvMBlockDescriptor [1..65536]  # Container for a management structure to configure the composition of a given NVRAM Block Management Type. Its multiplicity describes the number of configured NVRAM blocks, one block is required to be configured. The NVRAM block descriptors are condensed in the NVRAM block descriptor table.
      enumeration NvMBlockCrcType [0..1]: {NVM_CRC16, NVM_CRC32, NVM_CRC8}, multiplicity set at link in variant link-time / pre-compile in variant pre-compile, set at link in variant link-time / pre-compile in variant pre-compile  # Defines CRC data width for the NVRAM block. Default: NVM_CRC16, i.e. CRC16 will be used if NVM_BLOCK_USE_CRC==true
      string NvMBlockHeaderInclude [0..1]: multiplicity set at link in variant link-time / pre-compile in variant pre-compile, set at link in variant link-time / pre-compile in variant pre-compile  # Defines the header file where the owner of the NVRAM block has the declarations of the permanent RAM data block, ROM data block (if configured) and the callback function prototype for each configured callback. If no permanent RAM block, ROM block or callback functions are configured then this configuration parameter shall be ignored.
      integer NvMBlockJobPriority: 0..255, set at link in variant link-time / pre-compile in variant pre-compile  # Defines the job priority for a NVRAM block (0 = Immediate priority).
      enumeration NvMBlockManagementType: {NVM_BLOCK_DATASET, NVM_BLOCK_NATIVE, NVM_BLOCK_REDUNDANT}, set at link in variant link-time / pre-compile in variant pre-compile  # Defines the block management type for the NVRAM block.[NVM137]
      boolean NvMBlockUseAutoValidation: set at link in variant link-time / pre-compile in variant pre-compile, default-value=false  # Defines whether the RAM Block shall be auto validated during shutdown phase. | true: if auto validation mechanism is used, false: otherwise
      boolean NvMBlockUseCrc: set at link in variant link-time / pre-compile in variant pre-compile  # Defines CRC usage for the NVRAM block, i.e. memory space for CRC is reserved in RAM and NV memory. | true: CRC will be used for this NVRAM block. false: CRC will not be used for this NVRAM block.
      boolean NvMBlockUseCRCCompMechanism: set at link in variant link-time / pre-compile in variant pre-compile, default-value=false  # Defines whether the CRC of the RAM Block shall be compared during a write job with the CRC which was calculated during the last successful read or write job. | true: if compare mechanism is used, false: otherwise
      boolean NvMBlockUseSetRamBlockStatus: set at link in variant link-time / pre-compile in variant pre-compile  # Defines if NvMSetRamBlockStatusApi shall be used for this block or not. | Note: If NvMSetRamBlockStatusApi is disabled this configuration parameter shall be ignored. true: calling of NvMSetRamBlockStatus for this RAM block shall set the status of the RAM block. false: calling of NvMSetRamBlockStatus for this RAM block shall be ignored.
      boolean NvMBlockUseSyncMechanism: set at link in variant link-time / pre-compile in variant pre-compile, default-value=false  # Defines whether an explicit synchronization mechanism with a RAM mirror and callback routines for transferring data to and from NvM module's RAM mirror is used for NV block. true if synchronization mechanism is used, false otherwise.
      boolean NvMBlockWriteProt: set at link in variant link-time / pre-compile in variant pre-compile  # Defines an initial write protection of the NV block | true: Initial block write protection is enabled. false: Initial block write protection is disabled.
      boolean NvMBswMBlockStatusInformation: set at link in variant link-time / pre-compile in variant pre-compile, default-value=false  # This parameter specifies whether BswM is informed about the current status of the specified block. | True: Call BswM_NvM_CurrentBlockMode on changes False: Don't inform BswM at all
      boolean NvMCalcRamBlockCrc [0..1]: multiplicity set at link in variant link-time / pre-compile in variant pre-compile, set at link in variant link-time / pre-compile in variant pre-compile  # Defines CRC (re)calculation for the permanent RAM block or NVRAM blocks which are configured to use explicit synchronization mechanism. | true: CRC will be (re)calculated for this permanent RAM block. false: CRC will not be (re)calculated for this permanent RAM block.
      function name NvMInitBlockCallback [0..1]: multiplicity set at link in variant link-time / pre-compile in variant pre-compile, set at link in variant link-time / pre-compile in variant pre-compile  # Entry address of a block specific callback routine which shall be called if no ROM data is available for initialization of the NVRAM block. | If not configured, no specific callback routine shall be called for initialization of the NVRAM block with default data.
      integer NvMMaxNumOfReadRetries: 0..7, set at link in variant link-time / pre-compile in variant pre-compile, default-value=0  # Defines the maximum number of read retries.
      integer NvMMaxNumOfWriteRetries: 0..7, set at link in variant link-time / pre-compile in variant pre-compile  # Defines the maximum number of write retries for a NVRAM block with [ECUC_NvM_00061]. Regardless of configuration a consistency check (and maybe write retries) are always forced for each block which is processed by the request NvM_WriteAll and NvM_WriteBlock.
      integer NvMNvBlockBaseNumber: 1..65534, set at link in variant link-time / pre-compile in variant pre-compile  # Configuration parameter to perform the link between the NVM_NVRAM_BLOCK_IDENTIFIER used by the SW-Cs and the FEE_BLOCK_NUMBER expected by the memory abstraction modules. The parameter value equals the FEE_BLOCK_NUMBER or EA_BLOCK_NUMBER shifted to the right by NvMDatasetSelectionBits bits. (ref. to chapter 7.1.2.1). | Calculation Formula: value = TargetBlockReference.[Ea/Fee]BlockConfiguration.[Ea/Fee]BlockNumber >> NvMDatasetSelectionBits
      integer NvMNvBlockLength: 1..65535, set at link in variant link-time / pre-compile in variant pre-compile  # Defines the NV block data length in bytes. | Note: The implementer can add the attribute 'withAuto' to the parameter definition which indicates that the length can be calculated by the generator automatically (e.g. by using the sizeof operator). When 'withAuto' is set to 'true' for this parameter definition the 'isAutoValue' can be set to 'true'. If 'isAutoValue' is set to 'true' the actual value will not be considered during ECU Configuration but will be (re-)calculated by the code generator and stored in the value attribute afterwards.
      integer NvMNvBlockNum: 1..255, set at link in variant link-time / pre-compile in variant pre-compile  # Defines the number of multiple NV blocks in a contiguous area according to the given block management type. | 1-255 For NVRAM blocks to be configured of block management type NVM_BLOCK_DATASET. The actual range is limited according to SWS_NvM_00444. 1 For NVRAM blocks to be configured of block management type NVM_BLOCK_NATIVE 2 For NVRAM blocks to be configured of block management type NVM_BLOCK_REDUNDANT
      integer NvMNvramBlockIdentifier: 2..65535, set at pre-compile, symbolic-name-value=true  # Identification of a NVRAM block via a unique block identifier. | Implementation Type: NvM_BlockIdType. min = 2 max = 2^(16- NVM_DATASET_SELECTION_BITS)-1 Reserved NVRAM block IDs: 0 -> to derive multi block request results via NvM_GetErrorStatus 1 -> redundant NVRAM block which holds the configuration ID (generation tool should check that this block is correctly configured from type,CRC and size point of view)
      integer NvMNvramDeviceId: 0..1, set at link in variant link-time / pre-compile in variant pre-compile  # Defines the NVRAM device ID where the NVRAM block is located. | Calculation Formula: value = TargetBlockReference.[Ea/Fee]BlockConfiguration.[Ea/Fee]DeviceIndex
      string NvMRamBlockDataAddress [0..1]: multiplicity set at link in variant link-time / pre-compile in variant pre-compile, set at link in variant link-time / pre-compile in variant pre-compile  # Defines the start address of the RAM block data. | If this is not configured, no permanent RAM data block is available for the selected block management type.
      function name NvMReadRamBlockFromNvCallback [0..1]: multiplicity set at link in variant link-time / pre-compile in variant pre-compile, set at link in variant link-time / pre-compile in variant pre-compile  # Entry address of a block specific callback routine which shall be called in order to let the application copy data from the NvM module's mirror to RAM block. | Implementation type: Std_ReturnType E_OK: copy was successful E_NOT_OK: copy was not successful, callback routine to be called again
      boolean NvMResistantToChangedSw: set at link in variant link-time / pre-compile in variant pre-compile  # Defines whether a NVRAM block shall be treated resistant to configuration changes or not. If there is no default data available at configuration time then the application shall be responsible for providing the default initialization data. In this case the application has to use NvM_GetErrorStatus()to be able to distinguish between first initialization and corrupted data. | true: NVRAM block is resistant to changed software. false: NVRAM block is not resistant to changed software.
      string NvMRomBlockDataAddress [0..1]: multiplicity set at link in variant link-time / pre-compile in variant pre-compile, set at link in variant link-time / pre-compile in variant pre-compile  # Defines the start address of the ROM block data. | If not configured, no ROM block is available for the selected block management type.
      integer NvMRomBlockNum: 0..254, set at link in variant link-time / pre-compile in variant pre-compile  # Defines the number of multiple ROM blocks in a contiguous area according to the given block management type. | 0-254 For NVRAM blocks to be configured of block management type NVM_BLOCK_DATASET. The actual range is limited according to SWS_NvM_00444. 0-1 For NVRAM blocks to be configured of block management type NVM_BLOCK_NATIVE 0-1 For NVRAM blocks to be configured of block management type NVM_BLOCK_REDUNDANT
      boolean NvMSelectBlockForFirstInitAll [0..1]: multiplicity set at link in variant link-time / pre-compile in variant pre-compile, set at link in variant link-time / pre-compile in variant pre-compile, default-value=false  # Defines whether a block will be processed or not by NvM_FirstInitAll. A block can be configured to be processed even if it doesn't have permanent RAM and/or explicit synchronization. | TRUE: block will be processed by NvM_FirstInitAll FALSE: block will not be processed by NvM_FirstInitAll
      boolean NvMSelectBlockForReadAll [0..1]: multiplicity set at link in variant link-time / pre-compile in variant pre-compile, set at link in variant link-time / pre-compile in variant pre-compile  # Defines whether a NVRAM block shall be processed during NvM_ReadAll or not. This configuration parameter has only influence on those NVRAM blocks which are configured to have a permanent RAM block or which are configured to use explicit synchronization mechanism. | true: NVRAM block shall be processed by NvM_ReadAll false: NVRAM block shall not be processed by NvM_ReadAll
      boolean NvMSelectBlockForWriteAll [0..1]: multiplicity set at link in variant link-time / pre-compile in variant pre-compile, set at link in variant link-time / pre-compile in variant pre-compile  # Defines whether a NVRAM block shall be processed during NvM_WriteAll or not. This configuration parameter has only influence on those NVRAM blocks which are configured to have a permanent RAM block or which are configured to use explicit synchronization mechanism. | true: NVRAM block shall be processed by NvM_WriteAll false: NVRAM block shall not be processed by NvM_WriteAll
      function name NvMSingleBlockCallback [0..1]: multiplicity set at link in variant link-time / pre-compile in variant pre-compile, set at link in variant link-time / pre-compile in variant pre-compile  # Entry address of the block specific callback routine which shall be invoked on termination of each asynchronous single block request [NVM113].
      boolean NvMStaticBlockIDCheck: set at link in variant link-time / pre-compile in variant pre-compile, default-value=false  # Defines if the Static Block ID check is enabled. | false: Static Block ID check is disabled. true: Static Block ID check is enabled.
      boolean NvMWriteBlockOnce: set at link in variant link-time / pre-compile in variant pre-compile  # Defines write protection after first write. The NVRAM manager sets the write protection bit either after the NV block was written the first time or if the block was already written and it is detected as valid and consistent during a read for it. [NVM276]. | true: Defines write protection after first write is enabled. false: Defines write protection after first write is disabled.
      function name NvMWriteRamBlockToNvCallback [0..1]: multiplicity set at link in variant link-time / pre-compile in variant pre-compile, set at link in variant link-time / pre-compile in variant pre-compile  # Entry address of a block specific callback routine which shall be called in order to let the application copy data from RAM block to NvM module's mirror. | Implementation type: Std_ReturnType E_OK: copy was successful E_NOT_OK: copy was not successful, callback routine to be called again
      boolean NvMWriteVerification: set at link in variant link-time / pre-compile in variant pre-compile, default-value=false  # Defines if Write Verification is enabled. | false: Write verification is disabled. true: Write Verification is enabled.
      integer NvMWriteVerificationDataSize: 1..65535, set at link in variant link-time / pre-compile in variant pre-compile  # Defines the number of bytes to compare in each step when comparing the content of a RAM Block and a block read back.
      choice container NvMTargetBlockReference  # This parameter is just a container for the parameters for EA and FEE
        container NvMEaRef [0..1]  # EEPROM Abstraction
          reference NvMNameOfEaBlock: set at link in variant link-time / pre-compile in variant pre-compile, requires-symbolic-name-value=true, destination=EaBlockConfiguration  # reference to EaBlock
        container NvMFeeRef [0..1]  # Flash EEPROM Emulation
          reference NvMNameOfFeeBlock: set at link in variant link-time / pre-compile in variant pre-compile, requires-symbolic-name-value=true, destination=FeeBlockConfiguration  # reference to FeeBlock
    container NvMCommon  # Container for common configuration options.
      enumeration NvMApiConfigClass: {NVM_API_CONFIG_CLASS_1, NVM_API_CONFIG_CLASS_2, NVM_API_CONFIG_CLASS_3}, set at pre-compile  # Preprocessor switch to enable some API calls which are related to NVM API configuration classes.
      boolean NvMBswMMultiBlockJobStatusInformation: set at link in variant link-time / pre-compile in variant pre-compile, default-value=true  # This parameter specifies whether BswM is informed about the current status of the multiblock job. | True: call BswM_NvM_CurrentJobMode if ReadAll and WriteAll are started, finished, canceled False: do not inform BswM at all
      integer NvMCompiledConfigId: 0..65535, set at pre-compile  # Configuration ID regarding the NV memory layout. This configuration ID shall be published as e.g. a SW-C shall have the possibility to write it to NV memory.
      integer NvMCrcNumOfBytes: 1..65535, set at link in variant link-time / pre-compile in variant pre-compile  # If CRC is configured for at least one NVRAM block, this parameter defines the maximum number of bytes which shall be processed within one cycle of job processing.
      integer NvMDatasetSelectionBits: 0..8, set at link in variant link-time / pre-compile in variant pre-compile  # Defines the number of least significant bits which shall be used to address a certain dataset of a NVRAM block within the interface to the memory hardware abstraction. | 0..8: Number of bits which are used for dataset or redundant block addressing. 0: No dataset or redundant NVRAM blocks are configured at all, no selection bits required. 1: In case of redundant NVRAM blocks are configured, but no dataset NVRAM blocks.
      boolean NvMDevErrorDetect: set at pre-compile, default-value=false  # Switches the development error detection and notification on or off. | * true: detection and notification is enabled. * false: detection and notification is disabled.
      boolean NvMDrvModeSwitch: set at link in variant link-time / pre-compile in variant pre-compile  # Preprocessor switch to enable switching memory drivers to fast mode during performing NvM_ReadAll and NvM_WriteAll | true: Fast mode enabled. false: Fast mode disabled.
      boolean NvMDynamicConfiguration: set at link in variant link-time / pre-compile in variant pre-compile  # Preprocessor switch to enable the dynamic configuration management handling by the NvM_ReadAll request. | true: Dynamic configuration management handling enabled. false: Dynamic configuration management handling disabled. This parameter affects all NvM processing related to Block with ID 1 and all processing related to Resistant to Changed Software. If the Dynamic Configuration is disabled, Block 1 cannot be used by NvM.
      boolean NvMJobPrioritization: set at link in variant link-time / pre-compile in variant pre-compile  # Preprocessor switch to enable job prioritization handling | true: Job prioritization handling enabled. false: Job prioritization handling disabled.
      float NvMMainFunctionPeriod: 0..Inf, scope=ECU, set at pre-compile  # The period between successive calls to the main function in seconds.
      function name NvMMultiBlockCallback [0..1]: multiplicity set at link in variant link-time / pre-compile in variant pre-compile, set at link in variant link-time / pre-compile in variant pre-compile  # Entry address of the common callback routine which shall be invoked on termination of each asynchronous multi block request
      boolean NvMPollingMode: set at link in variant link-time / pre-compile in variant pre-compile  # Preprocessor switch to enable/disable the polling mode in the NVRAM Manager and at the same time disable/enable the callback functions useable by lower layers | true: Polling mode enabled, callback function usage disabled. false: Polling mode disabled, callback function usage enabled.
      integer NvMRepeatMirrorOperations: 0..7, set at link in variant link-time / pre-compile in variant pre-compile, default-value=0  # Defines the number of retries to let the application copy data to or from the NvM module's mirror before postponing the current job.
      boolean NvMSetRamBlockStatusApi: set at pre-compile  # Preprocessor switch to enable the API NvM_SetRamBlockStatus. | true: API NvM_SetRamBlockStatus enabled. false: API NvM_SetRamBlockStatus disabled.
      integer NvMSizeImmediateJobQueue [0..1]: 1..65535, multiplicity set at link in variant link-time / pre-compile in variant pre-compile, set at link in variant link-time / pre-compile in variant pre-compile  # Defines the number of queue entries for the immediate priority job queue. If NVM_JOB_PRIORITIZATION is switched OFF this parameter shall be out of scope.
      integer NvMSizeStandardJobQueue: 1..65535, set at link in variant link-time / pre-compile in variant pre-compile  # Defines the number of queue entries for the standard job queue.
      boolean NvMVersionInfoApi: set at pre-compile, default-value=false  # Pre-processor switch to enable / disable the API to read out the modules version information [NVM285], [NVM286]. | true: Version info API enabled. false: Version info API disabled.
    container NvmDemEventParameterRefs [0..1]  # Container for the references to DemEventParameter elements which shall be invoked using the API Dem_SetEventStatus in case the corresponding error occurs. The EventId is taken from the referenced DemEventParameter's DemEventId symbolic value. The standardized errors are provided in this container and can be extended by vendor-specific error references.
      reference NVM_E_HARDWARE [0..1]: scope=ECU, multiplicity set at pre-compile, set at pre-compile, requires-symbolic-name-value=true, destination=DemEventParameter  # Reference to the DemEventParameter which shall be issued when the hardware error has occured.
      reference NVM_E_INTEGRITY_FAILED [0..1]: scope=ECU, multiplicity set at pre-compile, set at pre-compile, requires-symbolic-name-value=true, destination=DemEventParameter  # Reference to the DemEventParameter which shall be issued when the error "API request integrity failed" has occurred.
      reference NVM_E_LOSS_OF_REDUNDANCY [0..1]: scope=ECU, multiplicity set at pre-compile, set at pre-compile, requires-symbolic-name-value=true, destination=DemEventParameter  # Reference to the DemEventParameter which shall be issued when the error "loss of redundancy" has occurred.
      reference NVM_E_REQ_FAILED [0..1]: scope=ECU, multiplicity set at pre-compile, set at pre-compile, requires-symbolic-name-value=true, destination=DemEventParameter  # Reference to the DemEventParameter which shall be issued when the error "API request failed" has occurred.
      reference NVM_E_VERIFY_FAILED [0..1]: scope=ECU, multiplicity set at pre-compile, set at pre-compile, requires-symbolic-name-value=true, destination=DemEventParameter  # Reference to the DemEventParameter which shall be issued when the error "Write Verification failed" has occurred.
      reference NVM_E_WRITE_PROTECTED [0..1]: scope=ECU, multiplicity set at pre-compile, set at pre-compile, requires-symbolic-name-value=true, destination=DemEventParameter  # Reference to the DemEventParameter which shall be issued when the error "write attempt to NVRAM block with write protection" has occurred.
      reference NVM_E_WRONG_BLOCK_ID [0..1]: scope=ECU, multiplicity set at pre-compile, set at pre-compile, requires-symbolic-name-value=true, destination=DemEventParameter  # Reference to the DemEventParameter which shall be issued when the error "Static Block ID check failed" has occurred.
  module definition Ocu [0..1]: post-build-variant-support=true, variants post-build/pre-compile  # Configuration of Ocu (Output Compare Unit) module.
    container OcuConfigSet  # This container is the base of a Configuration Set, which contains the configured OCU channels. This way, different configuration sets can be defined for post-build process.
      enumeration OcuCountdirection [0..1]: {OCU_DOWNCOUNTING, OCU_UPCOUNTING}, multiplicity set at post-build in variant post-build / pre-compile in variant pre-compile, post-build-variant-multiplicity=true, post-build-variant-value=true, set at post-build in variant post-build / pre-compile in variant pre-compile, default-value=OCU_UPCOUNTING  # This parameter indicates the count direction for the whole OCU driver.
      container OcuChannel [1..*]  # Configuration of an individual OCU channel.
        integer OcuAssignedHardwareChannel: 0..255, post-build-variant-value=true, set at post-build in variant post-build / pre-compile in variant pre-compile  # The physical hardware channel that is assigned to this logical channel.
        integer OcuChannelId: 0..65535, set at pre-compile, symbolic-name-value=true  # Channel Id of the OCU channel. This value will be assigned to the symbolic name derived from the OcuChannel container short name. It defines the assignment of the channel to the physical OCU hardware channel.
        integer OcuChannelTickDuration: 1..32768, post-build-variant-value=true, set at post-build in variant post-build / pre-compile in variant pre-compile  # Specifies the number of input clock edges (rising or falling edges) required to increase the channel counter by one (i.e. one counter tick). The value range depends on the used HW, not all values may be relevant
        integer OcuDefaultThreshold: 0..4294967295, post-build-variant-value=true, set at post-build in variant post-build / pre-compile in variant pre-compile  # Value of comparison threshold used for Initialization.
        integer OcuHardwareTriggeredAdc [0..1]: 0..255, multiplicity set at post-build in variant post-build / pre-compile in variant pre-compile, post-build-variant-multiplicity=true, post-build-variant-value=true, set at post-build in variant post-build / pre-compile in variant pre-compile, default-value=0  # This parameter is used to allow the OCU channel to trigger an ADC channel upon compare match, if this is supported by hardware. The value of the parameter represents the ADC physical channel to trigger.
        integer OcuHardwareTriggeredDMA [0..1]: 0..255, multiplicity set at post-build in variant post-build / pre-compile in variant pre-compile, post-build-variant-multiplicity=true, post-build-variant-value=true, set at post-build in variant post-build / pre-compile in variant pre-compile, default-value=0  # This parameter is used to allow the OCU channel to trigger a DMA channel upon compare match, if this is supported by hardware. The value of the parameter represents the DMA physical channel to trigger.
        integer OcuMaxCounterValue: 1..4294967295, post-build-variant-value=true, set at post-build in variant post-build / pre-compile in variant pre-compile  # Maximum value in ticks, the counter of the OCU channel is able to count.
        function name OcuNotification [0..1]: multiplicity set at post-build in variant post-build / pre-compile in variant pre-compile, post-build-variant-multiplicity=true, post-build-variant-value=true, set at post-build in variant post-build / pre-compile in variant pre-compile  # Definition of a function pointer to a Callback function.
        boolean OcuOuptutPinUsed: set at pre-compile  # Information about the usage of an output pin on this channel. | True: the channel uses an output pin. False: the channel does not use an output pin.
        enumeration OcuOutputPinDefaultState [0..1]: {OCU_HIGH, OCU_LOW}, multiplicity set at post-build in variant post-build / pre-compile in variant pre-compile, post-build-variant-multiplicity=true, post-build-variant-value=true, set at post-build in variant post-build / pre-compile in variant pre-compile  # The parameter OcuOutputPinDefaultState represents the state that a pin associated with a channel shall be set to after initialisation.
        reference OcuChannelEcucPartitionRef [0..*]: scope=ECU, multiplicity set at pre-compile, post-build-variant-multiplicity=true, post-build-variant-value=true, set at pre-compile, destination=EcucPartition  # Maps an OCU channel to zero or multiple ECUC partitions to limit the access to this channel. The ECUC partitions referenced are a subset of the ECUC partitions where the OCU driver is mapped to. Tags: atp.Status=draft
      container OcuHWSpecificSettings [0..1]  # This container contains Ocu-specific parameters for selecting the clock source and setting optional prescalers if supported by hardware. | Implementation is defined vendor specific.
        enumeration OcuClockSource [0..1]: multiplicity set at post-build in variant post-build / pre-compile in variant pre-compile, post-build-variant-multiplicity=true, post-build-variant-value=true, set at post-build in variant post-build / pre-compile in variant pre-compile  # The OCU driver specific clock input for the unit can statically be configured to select different clock sources if provided by hardware. Enumeration literals are defined vendor specific.
        enumeration OcuPrescale [0..1]: multiplicity set at post-build in variant post-build / pre-compile in variant pre-compile, post-build-variant-multiplicity=true, post-build-variant-value=true, set at post-build in variant post-build / pre-compile in variant pre-compile  # Optional OCU driver specific clock prescale factor, if supported by hardware. Implementation is defined vendor specific.
    container OcuConfigurationOfOptionalApis  # Configuration of optional APIs.
      boolean OcuDeInitApi: set at pre-compile  # Adds / removes the service Ocu_DeInit() from the code.
      boolean OcuGetCounterApi: set at pre-compile  # Adds / removes the service Ocu_GetCounter() from the code.
      boolean OcuNotificationSupported: set at pre-compile  # Adds / removes the services Ocu_EnableNotification() and Ocu_DisableNotification() from the code.
      boolean OcuSetAbsoluteThresholdApi: set at pre-compile  # Adds / removes the service Ocu_SetAbsoluteThreshold() from the code.
      boolean OcuSetPinActionApi: set at pre-compile  # Adds / removes the service Ocu_SetPinAction() from the code.
      boolean OcuSetPinStateApi: set at pre-compile  # Adds / removes the service Ocu_SetPinState() from the code.
      boolean OcuSetRelativeThresholdApi: set at pre-compile  # Adds / removes the service Ocu_SetRelativeThreshold() from the code.
      boolean OcuVersionInfoApi: set at pre-compile, default-value=false  # Switch to indicate that the Ocu_GetVersionInfo() is supported.
    container OcuGeneral  # This container contains the module-wide configuration parameters of the OCU Driver.
      boolean OcuDevErrorDetect: set at pre-compile, default-value=false  # Switches the development error detection and notification on or off. | * true: detection and notification is enabled. * false: detection and notification is disabled.
      reference OcuEcucPartitionRef [0..*]: scope=ECU, multiplicity set at pre-compile, post-build-variant-multiplicity=true, post-build-variant-value=true, set at pre-compile, destination=EcucPartition  # Maps the OCU driver to zero or multiple ECUC partitions to make the driver API available in the according partition. Tags: atp.Status=draft
      reference OcuKernelEcucPartitionRef [0..1]: scope=ECU, multiplicity set at pre-compile, post-build-variant-multiplicity=true, post-build-variant-value=true, set at pre-compile, destination=EcucPartition  # Maps the OCU kernel to zero or one ECUC partitions to assign the driver kernel to a certain core. The ECUC partition referenced is a subset of the ECUC partitions where the OCU driver is mapped to. Tags: atp.Status=draft
  module definition Os [0..1]: variants pre-compile  # Configuration of the Os (Operating System) module.
    container OsAlarm [0..*]  # An OsAlarm may be used to asynchronously inform or activate a specific task. It is possible to start alarms automatically at system start-up depending on the application mode.
      reference OsAlarmAccessingApplication [0..*]: multiplicity set at pre-compile, set at pre-compile, destination=OsApplication  # Reference to applications which have an access to this object.
      reference OsAlarmCounterRef: set at pre-compile, destination=OsCounter  # Reference to the assigned counter for that alarm
      choice container OsAlarmAction  # This container defines which type of notification is used when the alarm expires.
        container OsAlarmActivateTask [0..1]  # This container specifies the parameters to activate a task.
          reference OsAlarmActivateTaskRef: set at pre-compile, destination=OsTask  # Reference to the task that will be activated by that alarm action
        container OsAlarmCallback [0..1]  # This container specifies the parameters to call a callback OS alarm action.
          function name OsAlarmCallbackName: set at pre-compile  # Name of the function that is called when this alarm callback is triggered.
        container OsAlarmIncrementCounter [0..1]  # This container specifies the parameters to increment a counter.
          reference OsAlarmIncrementCounterRef: scope=ECU, set at pre-compile, destination=OsCounter  # Reference to the counter that will be incremented by that alarm action
        container OsAlarmSetEvent [0..1]  # This container specifies the parameters to set an event
          reference OsAlarmSetEventRef: set at pre-compile, destination=OsEvent  # Reference to the event that will be set by that alarm action
          reference OsAlarmSetEventTaskRef: set at pre-compile, destination=OsTask  # Reference to the task that will be activated by that event
      container OsAlarmAutostart [0..1]  # If present this container defines if an alarm is started automatically at system start-up depending on the application mode.
        integer OsAlarmAlarmTime: 0..18446744073709551615, set at pre-compile  # The relative or absolute tick value when the alarm expires for the first time. Note that for an alarm which is RELATIVE the value must be at bigger than 0.
        enumeration OsAlarmAutostartType: {ABSOLUTE, RELATIVE}, set at pre-compile  # This specifies the type of autostart for the alarm..
        integer OsAlarmCycleTime: 0..18446744073709551615, set at pre-compile  # Cycle time of a cyclic alarm in ticks. If the value is 0 than the alarm is not cyclic.
        reference OsAlarmAppModeRef [1..*]: multiplicity set at pre-compile, set at pre-compile, destination=OsAppMode  # Reference to the application modes for which the AUTOSTART shall be performed
    container OsAppMode [1..*]  # OsAppMode is the object used to define ISO 17356-3 properties for an ISO 17356-3 application mode. | No standard attributes are defined for AppMode. In a CPU, at least one AppMode object has to be defined. [source: ISO 17356-6] An OsAppMode called OSDEFAULTAPPMODE must always be there for ISO 17356 compatibility.
    container OsApplication [0..*]  # An AUTOSAR OS must be capable of supporting a collection of OS objects (tasks, interrupts, alarms, hooks etc.) that form a cohesive functional unit. This collection of objects is termed an OS-Application. | All objects which belong to the same OS-Application have access to each other. Access means to allow to use these objects within API services. Access by other applications can be granted separately.
      boolean OsTrusted: scope=ECU, set at pre-compile, default-value=false  # Parameter to specify if an OS-Application is trusted or not. | true: OS-Application is trusted false: OS-Application is not trusted (default)
      boolean OsTrustedApplicationDelayTimingViolationCall: scope=ECU, set at pre-compile, default-value=true  # Parameter to specify if a timing violation which occurs within an trusted OS-Application is raised immediately of if it is delayed until the current task returns to the calling OS-Application (return of CallTrustedFunction) | true: violation / call to ProtectionHook() is delayed false: timing violation cause an immediate call to the ProtectionHook().
      boolean OsTrustedApplicationWithProtection: scope=ECU, set at pre-compile, default-value=false  # Parameter to specify if a trusted OS-Application is executed with memory protection or not. | true: OS-Application runs within a protected environment. This means that write access is limited. false: OS-Application has full write access (default)
      reference OsAppAlarmRef [0..*]: scope=ECU, multiplicity set at pre-compile, set at pre-compile, destination=OsAlarm  # Specifies the OsAlarms that belong to the OsApplication.
      reference OsAppCounterRef [0..*]: scope=ECU, multiplicity set at pre-compile, set at pre-compile, destination=OsCounter  # References the OsCounters that belong to the OsApplication.
      reference OsAppEcucPartitionRef [0..1]: multiplicity set at pre-compile, set at pre-compile, destination=EcucPartition  # Denotes which "EcucPartition" is implemented by this "OSApplication".
      reference OsAppIsrRef [0..*]: scope=ECU, multiplicity set at pre-compile, set at pre-compile, destination=OsIsr  # references which OsIsrs belong to the OsApplication
      reference OsApplicationCoreRef [0..1]: multiplicity set at pre-compile, set at pre-compile, destination=EcucCoreDefinition  # Reference to the Core Definition in the Ecuc Module where the CoreId is defined. This reference is used to describe to which Core the OsApplication is bound.
      reference OsAppScheduleTableRef [0..*]: scope=ECU, multiplicity set at pre-compile, set at pre-compile, destination=OsScheduleTable  # References the OsScheduleTables that belong to the OsApplication.
      reference OsAppTaskRef [0..*]: scope=ECU, multiplicity set at pre-compile, set at pre-compile, destination=OsTask  # references which OsTasks belong to the OsApplication
      reference OsRestartTask [0..1]: scope=ECU, multiplicity set at pre-compile, set at pre-compile, destination=OsTask  # Optionally one task of an OS-Application may be defined as Restart Task. | Multiplicity = 1: Restart Task is activated by the Operating System if the protection hook requests it. Multiplicity = 0: No task is automatically started after a protection error happened.
      container OsApplicationHooks  # Container to structure the OS-Application-specific hooks
        boolean OsAppErrorHook: scope=ECU, set at pre-compile  # Select the OS-Application error hook. | true: Hook is called false: Hook is not called
        boolean OsAppShutdownHook: scope=ECU, set at pre-compile  # Select the OS-Application specific shutdown hook for the OS-Application. | true: Hook is called false: Hook is not called
        boolean OsAppStartupHook: scope=ECU, set at pre-compile  # Select the OS-Application specific startup hook for the OS-Application. | true: Hook is called false: Hook is not called
        foreign reference OsMemoryMappingCodeLocationRef [0..1]: scope=ECU, set at pre-compile, destination-type=SW-ADDR-METHOD  # Reference to the memory mapping containing details about the section where the code is placed.
      container OsApplicationTrustedFunction [0..*]  # Container to structure the configuration parameters of trusted functions
        function name OsTrustedFunctionName: scope=ECU, set at pre-compile  # Trusted function (as part of a trusted OS-Application) available to other OS-Applications. This also supersedes the ISO 17356-6 attribute TRUSTED in APPLICATION because the optionality of this parameter is describing that already.
    container OsCounter [0..*]  # Configuration information for the counters that belong to the OsApplication.
      integer OsCounterMaxAllowedValue: 1..18446744073709551615, set at pre-compile  # Maximum possible allowed value of the system counter in ticks.
      integer OsCounterMinCycle: 1..18446744073709551615, set at pre-compile  # The MINCYCLE attribute specifies the minimum allowed number of counter ticks for a cyclic alarm linked to the counter.
      integer OsCounterTicksPerBase: 1..4294967295, set at pre-compile  # The TICKSPERBASE attribute specifies the number of ticks required to reach a counterspecific unit. The interpretation is implementation-specific.
      enumeration OsCounterType: {HARDWARE, SOFTWARE}, scope=ECU, set at pre-compile  # This parameter contains the natural type or unit of the counter.
      float OsSecondsPerTick [0..1]: 0..Inf, scope=ECU, multiplicity set at pre-compile, set at pre-compile  # Time of one counter tick in seconds.
      reference OsCounterAccessingApplication [0..*]: multiplicity set at pre-compile, set at pre-compile, destination=OsApplication  # Reference to applications which have an access to this object.
      container OsDriver [0..1]  # This Container contains the information who will drive the counter. | This configuration is only valid if the counter has OsCounterType set to HARDWARE. If the container does not exist (multiplicity=0) the timer is managed by the OS internally (OSINTERNAL). If the container exists the OS can use the GPT interface to manage the timer. The user have to supply the GPT channel. If the counter is driven by some other (external to the OS) source (like a TPU for example) this must be described as a vendor specific extension.
        reference OsGptChannelRef [0..1]: scope=ECU, multiplicity set at pre-compile, set at pre-compile, requires-symbolic-name-value=true, destination=GptChannelConfiguration  # Reference to the GPT channel.
      container OsTimeConstant [0..*]  # Allows the user to define constants which can be e.g. used to compare time values with timer tick values. | A time value will be converted to a timer tick value during generation and can later on accessed via the OsConstName. The conversation is done by rounding time values to the nearest fitting tick value.
        float OsTimeValue: 0..Inf, scope=ECU, set at pre-compile  # This parameter contains the value of the constant in seconds.
    container OsEvent [0..*]  # Representation of OS events in the configuration context. Adopted from the ISO 17356-6 specification.
      integer OsEventMask [0..1]: 0..18446744073709551615, multiplicity set at pre-compile, set at pre-compile  # If event mask would be set to AUTO in OIL, this parameter should be omitted here.
    container OsIoc [0..1]  # Configuration of the IOC (Inter OS Application Communicator).
      container OsIocCommunication [0..*]  # Representation of a 1:1 or N:1 or N:M (unqueued only) communication between software parts located in different OS-Applications that are bound to the same or to different cores. | The name shall begin with the name of the sending software service and be followed by a unique identifier delivered by the sending software service. In the case of RTE as user attention shall be paid on the fact that uniqueness for identifier names has to be reached over ports, data elements, object instances and maybe additional identification properties (E.g. Case 1:N mapping to 1:1). Example: - <NameSpace>_UniqueID
        integer OsIocBufferLength [0..1]: 0..4294967295, multiplicity set at pre-compile, set at pre-compile  # This attribute defines the size of the IOC internal queue to be allocated for a queued communication. | This configuration information shall allow the optimization of the needed memory for communications requiring buffers within the RTE and within the IOC.
        container OsIocDataProperties [1..*]  # Data properties of the data to be transferred on the IOC communication channel.
          integer OsIocDataPropertyIndex [0..1]: 0..255, multiplicity set at pre-compile, set at pre-compile  # This parameter is used to define in which order the data is send, e.g. whether IocSendGroup(A,B) or IocSendGroup(B,A) shall be used.
          string OsIocInitValue [0..1]: multiplicity set at pre-compile, set at pre-compile  # Initial Value for the data to be transferred on the IOC communication channel.
          foreign reference OsIocDataTypeRef: set at pre-compile, destination-type=IMPLEMENTATION-DATA-TYPE  # This is the type of the data to be transferred on the IOC communication channel. This attribute is necessary to generate the parameter type of the Ioc functions. Additionally this information should be used to compute the data size for necessary data copy operations within the Ioc module. | If more than one attribute is defined, the IOC generator should generate an IocXxxGroup function (Xxx= CHOICE [Send, Receive, Write, Read]). N:1 or N:M communication (Multiplicity of OsIocSenderProperties > 1) is only allowed for multiplicity of OsIocDataTypeRef = 1
        container OsIocReceiverProperties [1..*]  # Representation of receiver properties for one communication. For each OsIocCommunication one (1:1) or many receivers (N:M) have to be defined. This container should be instantiated within an OsIocCommunication.
          enumeration OsIocFunctionImplementationKind [0..1]: {DO_NOT_CARE, FUNCTION, MACRO}, multiplicity set at pre-compile, set at pre-compile, default-value=DO_NOT_CARE  # This parameter is used to select whether this communication is implemented as a macro or as a function.
          function name OsIocReceiverPullCB [0..1]: multiplicity set at pre-compile, set at pre-compile  # This attribute defines the name of a callback function that the IOC shall call on the receiving core for each data reception. | In case of non existence of this attribute no ReceiverPullCB notification shall be applied by the IOC. The name of the function shall begin with the name of the receiving module, followed with a callback name and followed by the IocId. Example: void RTE_ReceiverPullCB_RTE25 (void). If this attribute does not exist, it means that no ReceiverPullCB shall be called (No notification from IOC is required). If this attribute exists the IOC shall call the callback function on the receiving core.
          reference OsIocReceivingOsApplicationRef: set at pre-compile, destination=OsApplication  # This attribute is a reference to the receiving OsApplication instance defined in the configuration file of the OS. | This information allows for the generator to get additional information necessary for the code generation like: * The protection properties of the communicating OsApplications to find out which protections have to be crossed * The core identifiers to find out if an intra or an inter core communication has to be realized * Interrupt details in case of cross core notification to realize over IRQs
        container OsIocSenderProperties [1..*]  # Representation of sender properties for one communication. For each OsIocCommunication one (1:1) or many senders (N:1 or N:M) have to be defined. Multiplicity > 1 (N:1 or N:M communication) is only allowed for Multiplicity of OsIocDataTypeRef = 1. | This container should be instantiated within an OsIocCommunication.
          enumeration OsIocFunctionImplementationKind [0..1]: {DO_NOT_CARE, FUNCTION, MACRO}, multiplicity set at pre-compile, set at pre-compile, default-value=DO_NOT_CARE  # This parameter is used to select whether this communication is implemented as a macro or as a function.
          integer OsIocSenderId [0..1]: 0..255, scope=ECU, multiplicity set at pre-compile, set at pre-compile  # Representation of a sender in a N:1 or N:M communication to distinguish between senders. | This parameter does not exist in 1:1 communication.
          reference OsIocSendingOsApplicationRef: set at pre-compile, destination=OsApplication  # This attribute is a reference to the sending OS-Application instance defined in the configuration file of the OS. | This information shall allows the generator to get additional information necessary for the code generation like: * The protection properties of the communicating OS-Applications to find out which protection boundaries have to be crossed. * The core identifiers to find out if an intra or an inter core communication has to be realized * Interrupt details in case of cross core notification to realize over IRQs
    container OsIsr [0..*]  # The OsIsr container represents an ISO 17356 interrupt service routine.
      enumeration OsIsrCategory: {CATEGORY_1, CATEGORY_2}, set at pre-compile  # This attribute specifies the category of this ISR.
      reference OsIsrResourceRef [0..*]: multiplicity set at pre-compile, set at pre-compile, destination=OsResource  # This reference defines the resources accessed by this ISR.
      foreign reference OsMemoryMappingCodeLocationRef [0..1]: scope=ECU, set at pre-compile, destination-type=SW-ADDR-METHOD  # Reference to the memory mapping containing details about the section where the code is placed.
      container OsIsrTimingProtection [0..1]  # This container contains all parameters which are related to timing protection | If the container exists, the timing protection is used for this interrupt. If the container does not exist, the interrupt is not supervised regarding timing violations.
        float OsIsrAllInterruptLockBudget [0..1]: 0..Inf, scope=ECU, multiplicity set at pre-compile, set at pre-compile  # This parameter contains the maximum time for which the ISR is allowed to lock all interrupts (via SuspendAllInterrupts() or DisableAllInterrupts()) (in seconds).
        float OsIsrExecutionBudget [0..1]: 0..Inf, scope=ECU, multiplicity set at pre-compile, set at pre-compile  # The parameter contains the maximum allowed execution time of the interrupt (in seconds).
        float OsIsrOsInterruptLockBudget [0..1]: 0..Inf, scope=ECU, multiplicity set at pre-compile, set at pre-compile  # This parameter contains the maximum time for which the ISR is allowed to lock all Category 2 interrupts (via SuspendOSInterrupts()) (in seconds).
        float OsIsrTimeFrame [0..1]: 0..Inf, scope=ECU, multiplicity set at pre-compile, set at pre-compile  # This parameter contains the minimum inter-arrival time between successive interrupts (in seconds).
        container OsIsrResourceLock [0..*]  # This container contains a list of times the interrupt uses resources.
          float OsIsrResourceLockBudget: 0..Inf, scope=ECU, set at pre-compile  # This parameter contains the maximum time the interrupt is allowed to hold the given resource (in seconds).
          reference OsIsrResourceLockResourceRef: scope=ECU, set at pre-compile, destination=OsResource  # Reference to the resource the locking time is depending on
    container OsOS  # OS is the object used to define ISO 17356-3 properties for an ISO 17356 application. | Per CPU exactly one OS object has to be defined.
      integer OsNumberOfCores [0..1]: 1..65535, multiplicity set at pre-compile, set at pre-compile  # Maximum number of cores that are controlled by the OS. | The OS uses the value internally. It depends on the ECU HW.
      enumeration OsScalabilityClass [0..1]: {SC1, SC2, SC3, SC4}, scope=ECU, set at pre-compile  # A scalability class for each System Object "OS" has to be selected. In order to customize the operating system to the needs of the user and to take full advantage of the processor features the operating system can be scaled according to the scalability classes. | If the scalability class is omitted this translates to the OIL AUTO mechanism.
      boolean OsStackMonitoring: scope=ECU, set at pre-compile  # Select stack monitoring of Tasks/Category 2 ISRs | true: Stacks are monitored false: Stacks are not monitored
      enumeration OsStatus: {EXTENDED, STANDARD}, set at pre-compile  # The Status attribute specifies whether a system with standard or extended status has to be used. Automatic assignment is not supported for this attribute.
      boolean OsUseGetServiceId: set at pre-compile  # As defined by ISO 17356
      boolean OsUseParameterAccess: set at pre-compile  # As defined by ISO 17356
      boolean OsUseResScheduler: set at pre-compile, default-value=true  # The OsUseResScheduler attribute defines whether the resource RES_SCHEDULER is used within the application.
      container OsHooks  # Container to structure all hooks belonging to the OS
        boolean OsErrorHook: set at pre-compile  # Error hook as defined by ISO 17356 | true: Hook is called false: Hook is not called
        boolean OsPostTaskHook: set at pre-compile  # Post-task hook as defined by ISO 17356 | true: Hook is called false: Hook is not called
        boolean OsPreTaskHook: set at pre-compile  # Pre-task hook as defined by ISO 17356 | true: Hook is called false: Hook is not called
        boolean OsProtectionHook [0..1]: scope=ECU, multiplicity set at pre-compile, set at pre-compile  # Switch to enable/disable the call to the (user supplied) protection hook. | true: Protection hook is called on protection error false: Protection hook is not called
        boolean OsShutdownHook: set at pre-compile  # Shutdown hook as defined by ISO 17356 | true: Hook is called false: Hook is not called
        boolean OsStartupHook: set at pre-compile  # Startup hook as defined by ISO 17356 | true: Hook is called false: Hook is not called
        foreign reference OsMemoryMappingCodeLocationRef [0..1]: scope=ECU, set at pre-compile, destination-type=SW-ADDR-METHOD  # Reference to the memory mapping containing details about the section where the code is placed.
    container OsPeripheralArea [0..65534]: multiplicity set at pre-compile  # Container to structure the configuration parameters of one peripheral area. The container short name can be used to access this area.
      integer OsPeripheralAreaEndAddress: 0..18446744073709551615, set at pre-compile  # Last valid address of a peripheral area.
      integer OsPeripheralAreaId: 0..18446744073709551615, symbolic-name-value=true  # Id of peripheral area.
      integer OsPeripheralAreaStartAddress: 0..18446744073709551615, set at pre-compile  # First valid address of a peripheral area.
      reference OsPeripheralAreaAccessingApplication [0..*]: destination=OsApplication  # Reference to application which have access to this object.
    container OsResource [0..*]  # An OsResource object is used to co-ordinate the concurrent access by tasks and ISRs to a shared resource, e.g. the scheduler, any program sequence, memory or any hardware area.
      enumeration OsResourceProperty: {INTERNAL, LINKED, STANDARD}, set at pre-compile  # This specifies the type of the resource.
      reference OsResourceAccessingApplication [0..*]: multiplicity set at pre-compile, set at pre-compile, destination=OsApplication  # Reference to applications which have an access to this object.
      reference OsResourceLinkedResourceRef [0..1]: multiplicity set at pre-compile, set at pre-compile, destination=OsResource  # The link to the resource. Must be valid if OsResourceProperty is LINKED. If OsResourceProperty is not LINKED the value is ignored.
    container OsScheduleTable [0..*]  # An OsScheduleTable addresses the synchronization issue by providing an encapsulation of a statically defined set of alarms that cannot be modified at runtime.
      integer OsScheduleTableDuration: 0..18446744073709551615, set at pre-compile  # This parameter defines the modulus of the schedule table (in ticks).
      boolean OsScheduleTableRepeating: scope=ECU, set at pre-compile  # true: first expiry point on the schedule table shall be processed at final expiry point delay ticks after the final expiry point is processed. | false: the schedule table processing stops when the final expiry point is processed.
      reference OsScheduleTableCounterRef: scope=ECU, set at pre-compile, destination=OsCounter  # This parameter contains a reference to the counter which drives the schedule table.
      reference OsSchTblAccessingApplication [0..*]: multiplicity set at pre-compile, set at pre-compile, destination=OsApplication  # Reference to applications which have an access to this object.
      container OsScheduleTableAutostart [0..1]  # This container specifies if and how the schedule table is started on startup of the Operating System. The options to start a schedule table correspond to the API calls to start schedule tables during runtime.
        enumeration OsScheduleTableAutostartType: {ABSOLUTE, RELATIVE, SYNCHRON}, set at pre-compile  # This specifies the type of the autostart for the schedule table.
        integer OsScheduleTableStartValue [0..1]: 0..18446744073709551615, scope=ECU, multiplicity set at pre-compile, set at pre-compile  # Absolute autostart tick value when the schedule table starts. Only used if the OsScheduleTableAutostartType is ABSOLUTE. | Relative offset in ticks when the schedule table starts. Only used if the OsScheduleTableAutostartType is RELATIVE.
        reference OsScheduleTableAppModeRef [1..*]: scope=ECU, multiplicity set at pre-compile, set at pre-compile, destination=OsAppMode  # Reference in which application modes the schedule table should be started during startup
      container OsScheduleTableExpiryPoint [1..*]  # The point on a Schedule Table at which the OS activates tasks and/or sets events
        integer OsScheduleTblExpPointOffset: 0..18446744073709551615, set at pre-compile  # The offset from zero (in ticks) at which the expiry point is to be processed.
        container OsScheduleTableEventSetting [0..*]  # Event that is triggered by that schedule table.
          reference OsScheduleTableSetEventRef: set at pre-compile, destination=OsEvent  # Reference to event that will be set by action
          reference OsScheduleTableSetEventTaskRef: set at pre-compile, destination=OsTask
        container OsScheduleTableTaskActivation [0..*]  # Task that is triggered by that schedule table.
          reference OsScheduleTableActivateTaskRef: scope=ECU, set at pre-compile, destination=OsTask  # Reference to task that will be activated by action
        container OsScheduleTblAdjustableExpPoint [0..1]  # Adjustable expiry point
          integer OsScheduleTableMaxLengthen: 0..18446744073709551615, set at pre-compile  # The maximum positive adjustment that can be made to the expiry point offset (in ticks).
          integer OsScheduleTableMaxShorten: 0..18446744073709551615, set at pre-compile  # The maximum negative adjustment that can be made to the expiry point offset (in ticks).
      container OsScheduleTableSync [0..1]  # This container specifies the synchronization parameters of the schedule table.
        integer OsScheduleTblExplicitPrecision [0..1]: 0..18446744073709551615, scope=ECU, multiplicity set at pre-compile, set at pre-compile  # This configuration is only valid if the explicit synchronization is used.
        enumeration OsScheduleTblSyncStrategy: {EXPLICIT, IMPLICIT, NONE}, scope=ECU, origin=AUTOSAR ECUC, set at pre-compile, default-value=NONE  # AUTOSAR OS provides support for synchronization in two ways: explicit and implicit.
    container OsSpinlock [0..*]  # An OsSpinlock object is used to co-ordinate concurrent access by TASKs/ISR2s on different cores to a shared resource.
      enumeration OsSpinlockLockMethod: {LOCK_ALL_INTERRUPTS, LOCK_CAT2_INTERRUPTS, LOCK_NOTHING, LOCK_WITH_RES_SCHEDULER}, set at pre-compile, default-value=LOCK_NOTHING  # Lock method which is used when a spinlock is taken. Note that it is possible that a user (e.g. a Task) might hold more than one spinlock. In this case the last lock taken is forced to use at least a lock methode which locks as strong as the current one.
      reference OsSpinlockAccessingApplication [1..*]: multiplicity set at pre-compile, set at pre-compile, destination=OsApplication  # Reference to OsApplications that have an access to this object.
      reference OsSpinlockSuccessor [0..1]: multiplicity set at pre-compile, set at pre-compile, destination=OsSpinlock  # Reference to OsApplications that have an access to this object. | To check whether a spinlock can be occupied (in a nested way) without any danger of deadlock, a linked list of spinlocks can be defined. A spinlock can only be occupied in the order of the linked list. It is allowed to skip a spinlock. If no linked list is specified, spinlocks cannot be nested.
    container OsTask [0..*]  # This container represents an ISO 17356 task.
      integer OsTaskActivation: 1..4294967295, set at pre-compile  # This attribute defines the maximum number of queued activation requests for the task. A value equal to "1" means that at any time only a single activation is permitted for this task. Note that the value must be a natural number starting at 1.
      integer OsTaskPriority: 0..4294967295, set at pre-compile  # The priority of a task is defined by the value of this attribute. This value has to be understood as a relative value, i.e. the values show only the relative ordering of the tasks. | ISO 17356-3 defines the lowest priority as zero (0); larger values correspond to higher priorities.
      enumeration OsTaskSchedule: {FULL, NON}, set at pre-compile  # The OsTaskSchedule attribute defines the preemptability of the task. | If this attribute is set to NON, no internal resources may be assigned to this task.
      foreign reference OsMemoryMappingCodeLocationRef [0..1]: scope=ECU, set at pre-compile, destination-type=SW-ADDR-METHOD  # Reference to the memory mapping containing details about the section where the code is placed.
      reference OsTaskAccessingApplication [0..*]: multiplicity set at pre-compile, set at pre-compile, destination=OsApplication  # Reference to applications which have an access to this object.
      reference OsTaskEventRef [0..*]: multiplicity set at pre-compile, set at pre-compile, destination=OsEvent  # This reference defines the list of events the extended task may react on.
      reference OsTaskResourceRef [0..*]: multiplicity set at pre-compile, set at pre-compile, destination=OsResource  # This reference defines a list of resources accessed by this task.
      container OsTaskAutostart [0..1]  # This container determines whether the task is activated during the system start-up procedure or not for some specific application modes. | If the task shall be activated during the system start-up, this container is present and holds the references to the application modes in which the task is auto-started.
        reference OsTaskAppModeRef [1..*]: multiplicity set at pre-compile, set at pre-compile, destination=OsAppMode  # Reference to application modes in which that task is activated on startup of the OS
      container OsTaskTimingProtection [0..1]  # This container contains all parameters regarding timing protection of the task.
        float OsTaskAllInterruptLockBudget [0..1]: 0..Inf, scope=ECU, multiplicity set at pre-compile, set at pre-compile  # This parameter contains the maximum time for which the task is allowed to lock all interrupts (via SuspendAllInterrupts() or DisableAllInterrupts()) (in seconds).
        float OsTaskExecutionBudget [0..1]: 0..Inf, scope=ECU, multiplicity set at pre-compile, set at pre-compile  # This parameter contains the maximum allowed execution time of the task (in seconds).
        float OsTaskOsInterruptLockBudget [0..1]: 0..Inf, scope=ECU, multiplicity set at pre-compile, set at pre-compile  # This parameter contains the maximum time for which the task is allowed to lock all Category 2 interrupts (via SuspendOSInterrupts()) (in seconds).
        float OsTaskTimeFrame [0..1]: 0..Inf, scope=ECU, multiplicity set at pre-compile, set at pre-compile  # The minimum inter-arrival time between activations and/or releases of a task (in seconds).
        container OsTaskResourceLock [0..*]  # This container contains the worst case time between getting and releasing a given resource (in seconds).
          float OsTaskResourceLockBudget: 0..Inf, scope=ECU, set at pre-compile  # This parameter contains the maximum time the task is allowed to lock the resource (in seconds)
          reference OsTaskResourceLockResourceRef: scope=ECU, set at pre-compile, destination=OsResource  # Reference to the resource used by the task
  module definition PduR [0..1]: post-build-variant-support=true, variants post-build/pre-compile  # Configuration of the PduR (PDU Router) module.
    container PduRBswModules [0..*]: multiplicity set at pre-compile  # Each container describes a specific BSW module (upper/CDD/lower/IpduM) that the PDU Router shall interface to. | The reason to have it as own configuration container instead of implication of the routing path is to be able to configure CDDs properly and to force module's to be used in a post-build situation even though no routing is made to/from this module (future configurations may include these modules).
      boolean PduRCancelReceive: set at pre-compile  # Specifies if the Transport protocol module supports the CancelReceive API or not. Value true the API is supported.
      boolean PduRCancelTransmit: set at pre-compile  # Specifies if the BSW module supports the CancelTransmit API or not. Value true the API is supported.
      boolean PduRCommunicationInterface: set at pre-compile  # Specifies if the BSW module supports the Communication Interface APIs or not. Value true the APIs are supported. | A module can have both Communication Interface APIs and Transport Protocol APIs (e.g. the COM module).
      boolean PduRLowerModule: set at pre-compile  # The PduRLowerModule will decide who will call the APIs and who will implement the APIs. | For example, if the CanIf module is referenced then the PDU Router module will implement the PduR_CanIfRxIndication API. And the PDUR module will call the CanIf_Transmit API. Other APIs are of course also covered. An upper module can also be an lower module (e.g. the IpduM module).
      boolean PduRRetransmission: set at pre-compile  # If set to true this means that the destination transport protocol module will use the retransmission feature. This parameter might be set to false if the retransmission feature is not used, even though the destination transport protocol is supporting it. | This parameter is only valid for transport protocol modules and gateway operations. If transmission from a local upper layer module this module will handle the retransmission.
      boolean PduRTransportProtocol: set at pre-compile  # The PDU Router module shall use the API parameters specified for transport protocol interface.
      boolean PduRTriggertransmit: set at pre-compile  # Specifies if the BSW module supports the TriggerTransmit API or not. Value true means that the BSW module supports the TriggerTransmit interface which a lower layer module can call and also that it can call the TriggerTransmit interface of an upper layer module. Value false means that the BSW module does not support the TriggerTransmit interface which a lower layer module can call and also that it shall not call the TriggerTransmit interface of an upper layer module.
      boolean PduRTxConfirmation: set at pre-compile  # Specifies if the BSW module supports the TxConfirmation API or not. Value true the API is supported.
      boolean PduRUpperModule: set at pre-compile  # The PduRUpperModule will decide who will call the APIs and who will implement the APIs. | For example, if the COM module is referenced then the PDU Router module will implement the PduR_Transmit API. And the PDUR module will call the Com_RxIndication API. Other APIs are of course also covered. An upper module can also be an lower module (e.g. the IpduM module).
      boolean PduRUseTag: set at pre-compile  # This parameter, if set to true, enables the usage of the tag (<up>) in the following API calls: | * PduR_<Up>CancelReceive * PduR_<Up>CancelTransmit Example: If used by COM and the parameter is enabled the PduR_ComCancelTransmit is used. The background is that upper layer modules differ in usage of this tag (e.g. COM is using the tag, DCM is not).
      foreign reference PduRBswModuleRef: set at pre-compile, destination-type=ECUC-MODULE-CONFIGURATION-VALUES  # This is a reference to one BSW module's configuration (i.e. not the ECUC parameter definition template). | Example, there could be several configurations of LinIf and this reference selects one of them.
    container PduRGeneral  # This container is a subcontainer of PduR and specifies the general configuration parameters of the PDU Router.
      boolean PduRDevErrorDetect: set at pre-compile, default-value=false  # Switches the development error detection and notification on or off. | * true: detection and notification is enabled. * false: detection and notification is disabled.
      boolean PduRMetaDataSupport [0..1]: multiplicity set at pre-compile, set at pre-compile, default-value=false  # Enable support for MetaData handling. The MetaData is defined by the referenced MetaDataType of the global PDU definitions. This feature may be used for efficient address based routing and generic CAN-CAN-routing, where the MetaData contains the CAN ID.
      boolean PduRVersionInfoApi: set at pre-compile, default-value=false  # If true the PduR_GetVersionInfo API is available.
      boolean PduRZeroCostOperation: set at pre-compile  # If set the PduR configuration generator will report an error if zero-cost-operation cannot be fulfilled. | This parameter shall be seen as an input requirement to the configuration generator.
    container PduRRoutingPaths  # Represents one table of routing paths. | This routing table allows multiple configurations that can be used to create several routing tables in the same configuration. This is mainly used for post-build (e.g. post-build selectable) but can be used by pre-compile and link-time for variant handling.
      integer PduRConfigurationId: 0..65535, post-build-variant-value=true, set at post-build in variant post-build / pre-compile in variant pre-compile  # Identification of the configuration of the PduR configuration. This identification can be read using the PduR API.
      integer PduRMaxRoutingPathCnt [0..1]: 0..65535, multiplicity set at pre-compile, set at pre-compile  # Maximum number of RoutingPaths in all RoutingTables. This parameter is needed only in case of post-build loadable implementation using static memory allocation.
      integer PduRMaxRoutingPathGroupCnt [0..1]: 0..65535, multiplicity set at pre-compile, set at pre-compile  # Maximum number of RoutingPathGroups. This parameter is needed only in case of post-build loadable implementation using static memory allocation.
      container PduRDestPdu [0..*]: multiplicity set at post-build in variant post-build / pre-compile in variant pre-compile, post-build-variant-multiplicity=true  # This container is a subcontainer of PduRRoutingPath and specifies one destination for the PDU to be routed.
        enumeration PduRDestPduDataProvision [0..1]: {PDUR_DIRECT, PDUR_TRIGGERTRANSMIT}, multiplicity set at post-build in variant post-build / pre-compile in variant pre-compile, post-build-variant-multiplicity=true, post-build-variant-value=true, set at post-build in variant post-build / pre-compile in variant pre-compile  # Specifies how data are provided: direct (as part of the Transmit call) or via | the TriggerTransmit callback function. Only required for non-TP gatewayed I-PDUs.
        integer PduRDestPduHandleId [0..1]: 0..65535, scope=ECU, multiplicity set at pre-compile, set at pre-compile, symbolic-name-value=true  # PDU identifier assigned by PDU Router. Used by communication interface and transport protocol modules for confirmation (PduR_<Lo>TxConfirmation) and for TriggerTransmit (PduR_<Lo>TriggerTransmit).
        boolean PduRTransmissionConfirmation: multiplicity set at pre-compile, set at pre-compile  # This parameter is only for communication interfaces. Transport protocol modules will always call the TxConfirmation function. | If set the destination communication interface module will call the TxConfirmation. However the TxConfirmation may be not called due to error. So the PduR shall not block until the TxConfirmation is called. One background for this parameter is for the PduR to know when all modules have confirmed a multicast operation.
        reference PduRDestPduRef: post-build-variant-value=true, set at post-build in variant post-build / pre-compile in variant pre-compile, destination=Pdu  # Destination PDU reference; reference to unique PDU identifier which shall be used by the PDU Router instead of the source PDU ID when calling the related function of the destination module.
      container PduRRoutingPath [0..*]: multiplicity set at post-build in variant post-build / pre-compile in variant pre-compile, post-build-variant-multiplicity=true  # This container is a subcontainer of PduRRoutingTable and specifies the routing path of a PDU.
        integer PduRQueueDepth [0..1]: 1..255, multiplicity set at post-build in variant post-build / pre-compile in variant pre-compile, post-build-variant-multiplicity=true, post-build-variant-value=true, set at post-build in variant post-build / pre-compile in variant pre-compile  # This parameter defines the queue depth for this routing path.
        integer PduRTpThreshold [0..1]: 0..65535, multiplicity set at post-build in variant post-build / pre-compile in variant pre-compile, post-build-variant-multiplicity=true, post-build-variant-value=true, set at post-build in variant post-build / pre-compile in variant pre-compile  # This parameter is only relevant for TP routings. | When configured, it enables on-the-fly routing and defines the number of bytes which must have been received before transmission on the destination bus may start. When omitted, direct TP routing is enforced. The PduRouter shall ensure that a buffer is allocated for this routing path which is at least as large as the threshold.
        reference PduRDestPduRRef: post-build-variant-value=true, set at post-build in variant post-build / pre-compile in variant pre-compile, destination=PduRDestPdu
        reference PduRDestTxBufferRef [0..*]: multiplicity set at post-build in variant post-build / pre-compile in variant pre-compile, post-build-variant-multiplicity=true, post-build-variant-value=true, set at post-build in variant post-build / pre-compile in variant pre-compile, destination=PduRTxBuffer  # Reference to a buffer in the PduR. This buffer is required for communication interface gatewaying, and for transport protocol gatewaying.
        reference PduRRoutingPathGroupRef [0..1]: post-build-variant-multiplicity=true, post-build-variant-value=true, set at post-build in variant post-build / pre-compile in variant pre-compile, destination=PduRRoutingPathGroup  # Reference to routing path destinations.
        reference PduRSrcPduRRef: post-build-variant-value=true, set at post-build in variant post-build / pre-compile in variant pre-compile, destination=PduRSrcPdu
        container PduRDefaultValue [0..1]  # Specifies the default value of the I-PDU. Only required for gateway operation and if at least one PDU specified by PduRDestPdu uses TriggerTransmit Data provision. | Represented as an array of IntegerParamDef.
          container PduRDefaultValueElement [0..*]: multiplicity set at post-build in variant post-build / pre-compile in variant pre-compile, post-build-variant-multiplicity=true  # Each value element is represented by the element and the position in an array.
            integer PduRDefaultValueElement: 0..255, post-build-variant-value=true, set at post-build in variant post-build / pre-compile in variant pre-compile  # The default value consists of a number of elements. Each element is one byte long and the number of elements is specified by SduLength. The position of this parameter in the container is specified by the PduRElementBytePosition parameter.
            integer PduRDefaultValueElementBytePosition: 0..4294967294, post-build-variant-value=true, set at post-build in variant post-build / pre-compile in variant pre-compile  # This parameter specifies the byte position of the element within the default value
      container PduRRoutingPathGroup [0..*]: multiplicity set at post-build in variant post-build / pre-compile in variant pre-compile, post-build-variant-multiplicity=true  # This container groups routing path destinations. Destinations are used instead of routing paths since a routing path can be 1:n. It is desirable to be able to enable/disable a specific bus (i.e. a destination) rather than a routing path. Of course it is possible to create groups that covers specific routing paths as well. | Enabling and disabling of routing path groups are made using the PduR API
        boolean PduRIsEnabledAtInit: post-build-variant-value=true, set at post-build in variant post-build / pre-compile in variant pre-compile  # If set to true this routing path group will be enabled after initializing the PDU Router module (i.e. enabled in the PduR_Init function).
        integer PduRRoutingPathGroupId: 0..65535, scope=ECU, set at pre-compile, symbolic-name-value=true  # Identification of the routing group. | The identification will be used by the disable/enable API in the PDU Router module API.
      container PduRSrcPdu [0..*]  # This container is a subcontainer of PduRRoutingPath and specifies the source of the PDU to be routed.
        integer PduRSourcePduBlockSize [0..1]: 1..4294967295, multiplicity set at post-build in variant post-build / pre-compile in variant pre-compile, post-build-variant-multiplicity=true, post-build-variant-value=true, set at post-build in variant post-build / pre-compile in variant pre-compile  # Minimum amount of buffer space required by receiving transport protocol layer to continue reception.
        integer PduRSourcePduHandleId: 0..65535, scope=ECU, set at pre-compile, symbolic-name-value=true  # PDU identifier assigned by PDU Router.
        boolean PduRSrcPduUpTxConf: scope=ECU, multiplicity set at post-build in variant post-build / pre-compile in variant pre-compile, post-build-variant-multiplicity=true, post-build-variant-value=true, set at post-build in variant post-build / pre-compile in variant pre-compile, default-value=true  # When enabled, the TxConfirmation will be | forwarded to the upper layer. Prerequisites: Lower layer and upper layer support TxConfirmation.
        reference PduRSrcPduRef: post-build-variant-value=true, set at post-build in variant post-build / pre-compile in variant pre-compile, destination=Pdu  # Source PDU reference; reference to unique PDU identifier which shall be used for the requested PDU Router operation.
      container PduRTxBuffer [0..*]: multiplicity set at pre-compile  # Specifies a buffer used for gatewaying via communication interfaces or transport protocols.
        integer PduRPduMaxLength: 1..4294967295, set at pre-compile  # Length of the Tx buffer in bytes. This parameter limits the size of buffered routed PDUs.
  module definition Port [0..1]: post-build-variant-support=true, variants post-build/pre-compile  # Configuration of the Port module.
    container PortConfigSet  # This container contains the configuration parameters and sub containers of the AUTOSAR Port module.
      container PortContainer [1..*]  # Container collecting the PortPins.
        integer PortNumberOfPortPins: 1..65535, set at pre-compile  # The number of specified PortPins in this PortContainer.
        container PortPin [1..*]  # Configuration of the individual port pins.
          enumeration PortPinDirection: {PORT_PIN_IN, PORT_PIN_OUT}, post-build-variant-value=true, set at post-build in variant post-build / pre-compile in variant pre-compile  # The initial direction of the pin (IN or OUT). If the direction is not changeable, the value configured here is fixed. | The direction must match the pin mode. E.g. a pin used for an ADC must be configured to be an in port. Implementation Type: Port_PinDirectionType
          boolean PortPinDirectionChangeable: post-build-variant-value=true, set at post-build in variant post-build / pre-compile in variant pre-compile  # Parameter to indicate if the direction is changeable on a port pin during runtime. | true: Port Pin direction changeable enabled. false: Port Pin direction changeable disabled.
          integer PortPinId: 1..65535, set at pre-compile, symbolic-name-value=true  # Pin Id of the port pin. This value will be assigned to the symbolic name derived from the port pin container short name.
          enumeration PortPinInitialMode: {PORT_PIN_MODE_ADC, PORT_PIN_MODE_CAN, PORT_PIN_MODE_DIO, PORT_PIN_MODE_DIO_GPT, PORT_PIN_MODE_DIO_WDG, PORT_PIN_MODE_FLEXRAY, PORT_PIN_MODE_ICU, PORT_PIN_MODE_LIN, PORT_PIN_MODE_MEM, PORT_PIN_MODE_PWM, PORT_PIN_MODE_SPI}, post-build-variant-value=true, set at post-build in variant post-build / pre-compile in variant pre-compile  # Port pin mode from mode list for use with Port_Init() function.
          enumeration PortPinLevelValue: {PORT_PIN_LEVEL_HIGH, PORT_PIN_LEVEL_LOW}, post-build-variant-value=true, set at post-build in variant post-build / pre-compile in variant pre-compile  # Port Pin Level value from Port pin list.
          enumeration PortPinMode [1..*]: {PORT_PIN_MODE_ADC, PORT_PIN_MODE_CAN, PORT_PIN_MODE_DIO, PORT_PIN_MODE_DIO_GPT, PORT_PIN_MODE_DIO_WDG, PORT_PIN_MODE_FLEXRAY, PORT_PIN_MODE_ICU, PORT_PIN_MODE_LIN, PORT_PIN_MODE_MEM, PORT_PIN_MODE_PWM, PORT_PIN_MODE_SPI}, multiplicity set at post-build in variant post-build / pre-compile in variant pre-compile, post-build-variant-multiplicity=true, post-build-variant-value=true, set at post-build in variant post-build / pre-compile in variant pre-compile  # Port pin mode from mode list. | Note that more than one mode is allowed by default. That way it is e.g. possible to combine DIO with another mode such as ICU.
          boolean PortPinModeChangeable: post-build-variant-value=true, set at post-build in variant post-build / pre-compile in variant pre-compile  # Parameter to indicate if the mode is changeable on a port pin during runtime. True: Port Pin mode changeable allowed. False: Port Pin mode changeable not permitted.
          reference PortPinEcucPartitionRef [0..*]: scope=ECU, multiplicity set at pre-compile, post-build-variant-multiplicity=true, post-build-variant-value=true, set at pre-compile, destination=EcucPartition  # Maps the Port pin to zero a multiple ECUC partitions. The ECUC partitions referenced are a subset of the ECUC partitions where the Port driver is mapped to. Tags: atp.Status=draft
    container PortGeneral  # Module wide configuration parameters of the PORT driver.
      boolean PortDevErrorDetect: set at pre-compile, default-value=false  # Switches the development error detection and notification on or off. | * true: detection and notification is enabled. * false: detection and notification is disabled.
      boolean PortSetPinDirectionApi: set at pre-compile  # Pre-processor switch to enable / disable the use of the function Port_SetPinDirection(). | TRUE: Enabled - Function Port_SetPinDirection() is available. FALSE: Disabled - Function Port_SetPinDirection() is not available.
      boolean PortSetPinModeApi: set at pre-compile  # Pre-processor switch to enable / disable the use of the function Port_SetPinMode(). | true: Enabled - Function Port_SetPinMode() is available. false: Disabled - Function Port_SetPinMode() is not available.
      boolean PortVersionInfoApi: set at pre-compile, default-value=false  # Pre-processor switch to enable / disable the API to read out the modules version information. | true: Version info API enabled. false: Version info API disabled.
      reference PortEcucPartitionRef [0..*]: scope=ECU, multiplicity set at pre-compile, post-build-variant-multiplicity=true, post-build-variant-value=true, set at pre-compile, destination=EcucPartition  # Maps the Port driver to zero a multiple ECUC partitions to make the modules API available in this partition. Tags: atp.Status=draft
  module definition Pwm [0..*]: post-build-variant-support=true, variants post-build/pre-compile  # Configuration of Pwm (Pulse Width Modulation) module.
    container PwmChannelConfigSet  # This container contains the configuration parameters and sub containers of the AUTOSAR Pwm module.
      container PwmChannel [1..*]  # Configuration of an individual PWM channel.
        enumeration PwmChannelClass [0..1]: {PWM_FIXED_PERIOD, PWM_FIXED_PERIOD_SHIFTED, PWM_VARIABLE_PERIOD}, multiplicity set at post-build in variant post-build / pre-compile in variant pre-compile, post-build-variant-multiplicity=true, post-build-variant-value=true, set at post-build in variant post-build / pre-compile in variant pre-compile  # Class of PWM Channel. | ImplementationType: Pwm_ChannelClassType
        integer PwmChannelId: 0..4294967295, set at pre-compile, symbolic-name-value=true  # Channel Id of the PWM channel. This value will be assigned to the symbolic name derived of the PwmChannel container short name.
        integer PwmDutycycleDefault: 0..32768, post-build-variant-value=true, set at post-build in variant post-build / pre-compile in variant pre-compile  # Value of duty cycle used for Initialization | 0, represents 0% 0x8000 represents 100%
        enumeration PwmIdleState: {PWM_HIGH, PWM_LOW}, post-build-variant-value=true, set at post-build in variant post-build / pre-compile in variant pre-compile  # The parameter PWM_IDLE_STATE represents the output state of the PWM after the signal is stopped (e.g. call of Pwm_SetOutputToIdle).
        function name PwmNotification [0..1]: multiplicity set at post-build in variant post-build / pre-compile in variant pre-compile, post-build-variant-multiplicity=true, post-build-variant-value=true, set at post-build in variant post-build / pre-compile in variant pre-compile, default-value="NULL"  # Definition of the Callback function.
        float PwmPeriodDefault: 0..Inf, post-build-variant-value=true, set at post-build in variant post-build / pre-compile in variant pre-compile  # Value of period used for Initialization.(in seconds).
        enumeration PwmPolarity: {PWM_HIGH, PWM_LOW}, post-build-variant-value=true, set at post-build in variant post-build / pre-compile in variant pre-compile  # Defines the starting polarity of each PWM channel.
        reference PwmChannelEcucPartitionRef [0..*]: scope=ECU, multiplicity set at pre-compile, post-build-variant-multiplicity=true, post-build-variant-value=true, set at pre-compile, destination=EcucPartition  # Maps a PWM channel to zero or multiple ECUC partitions to limit the access to this channe. The ECUC partitions referenced are a subset of the ECUC partitions where the PWM driver is mapped to. Tags: atp.Status=draft
        reference PwmMcuClockReferencePoint: scope=ECU, post-build-variant-value=true, set at post-build in variant post-build / pre-compile in variant pre-compile, destination=McuClockReferencePoint  # This parameter contains reference to the McuClockReferencePoint
    container PwmConfigurationOfOptApiServices
      boolean PwmDeInitApi: set at pre-compile  # Adds / removes the service Pwm_DeInit() from the code.
      boolean PwmGetOutputState: set at pre-compile
      boolean PwmSetDutyCycle: set at pre-compile
      boolean PwmSetOutputToIdle: set at pre-compile
      boolean PwmSetPeriodAndDuty: set at pre-compile
      boolean PwmVersionInfoApi: set at pre-compile, default-value=false  # Switch to indicate that the Pwm_ GetVersionInfo is supported
    container PwmGeneral
      boolean PwmDevErrorDetect: set at pre-compile, default-value=false  # Switches the development error detection and notification on or off. | * true: detection and notification is enabled. * false: detection and notification is disabled.
      boolean PwmDutycycleUpdatedEndperiod: set at pre-compile  # Switch for enabling the update of the duty cycle parameter at the end of the current period. | TRUE: update of duty cycle is done at the end of period of currently generated waveform (current waveform is finished). FALSE: update of duty cycle is done immediately (just after service call, current waveform is cut).
      integer PwmIndex: 0..4294967295, set at pre-compile  # Specifies the InstanceId of this module instance. If only one instance is present it shall have the Id 0.
      boolean PwmLowPowerStatesSupport [0..1]: multiplicity set at pre-compile, set at pre-compile, default-value=false  # Adds / removes all power state management related APIs (PWM_SetPowerState, PWM_GetCurrentPowerState, PWM_GetTargetPowerState, PWM_PreparePowerState, PWM_Main_PowerTransitionManager), indicating if the HW offers low power state management.
      boolean PwmNotificationSupported: set at pre-compile  # Switch to indicate that the notifications are supported
      boolean PwmPeriodUpdatedEndperiod: set at pre-compile  # Switch for enabling the update of the period parameter at the end of the current period. | TRUE: update of period/duty cycle is done at the end of period of currently generated waveform (current waveform is finished). FALSE: update of period/duty cycle is done immediately (just after service call, current waveform is cut).
      boolean PwmPowerStateAsynchTransitionMode [0..1]: multiplicity set at pre-compile, set at pre-compile, default-value=false  # Enables / disables support of the PWM Driver to the asynchronous power state transition.
      reference PwmEcucPartitionRef [0..*]: scope=ECU, multiplicity set at pre-compile, post-build-variant-multiplicity=true, post-build-variant-value=true, set at pre-compile, destination=EcucPartition  # Maps the PWM driver to zero or multiple ECUC partitions to make the driver API available in the according partition. Tags: atp.Status=draft
      reference PwmKernelEcucPartitionRef [0..1]: scope=ECU, multiplicity set at pre-compile, post-build-variant-multiplicity=true, post-build-variant-value=true, set at pre-compile, destination=EcucPartition  # Maps the PWM kernel to zero or one ECUC partitions to assign the driver kernel to a certain core. The ECUC partition referenced is a subset of the ECUC partitions where the PWM driver is mapped to. Tags: atp.Status=draft
      container PwmPowerStateConfig [0..*]  # Each instance of this parameter defines a power state and the callback to be called when this power state is reached.
        integer PwmPowerState: 0..18446744073709551615, set at pre-compile, symbolic-name-value=true  # Each instance of this parameter describes a different power state supported by the PWM HW. It should be defined by the HW supplier and used by the PWMDriver to reference specific HW configurations which set the PWM HW module in the referenced power state. | At least the power mode corresponding to full power state shall be always configured.
        function name PwmPowerStateReadyCbkRef: set at pre-compile  # Each instance of this parameter contains a reference to a power mode callback defined in a CDD or IoHwAbs component.
